// Generated from the English and Russian firmware translation tables.
const firmwareRuText = {"BOOTING":"Загрузка","SLEEPING":"Спящий режим","Going to sleep":"Переход в сон","File Transfer":"Передача файлов","Continue Reading":"Продолжить чтение","No open book":"Нет открытой книги","Start reading below":"Выберите книгу ниже","No files found":"Файлы не найдены","Select Chapter":"Выберите главу","No chapters":"Глав нет","End of book":"Конец книги","Empty chapter":"Пустая глава","Book finished!":"Книга завершена!","Congratulations, you finished this book.":"Поздравляем, вы завершили эту книгу.","What do you want to do now?":"Что вы хотите сделать теперь?","Next book to read:":"Следующая книга для чтения:","Go back to Home":"Вернуться на главную","Open the next book:":"Открыть следующую книгу:","Move finished book to /COMPLETED":"Переместить завершённую книгу в /COMPLETED","Forget book":"Забыть книгу","Sync progress to KOReader":"Синхронизировать прогресс с KOReader","Find more by this author":"Найти ещё от этого автора","Indexing":"Индексация","Memory error":"Ошибка памяти","Empty file":"Пустой файл","Out of bounds":"Выход за пределы","Loading...":"Загрузка...","Loading":"Загрузка","Loading font...":"Загрузка шрифта...","Loading font list...":"Загрузка списка шрифтов...","WiFi Networks":"Wi-Fi сети","No networks found":"Сети не найдены","%zu networks found":"Найдено сетей: %zu","Scanning...":"Сканирование...","Connecting...":"Подключение...","Finding saved WiFi...":"Поиск сохранённых сетей...","Connecting to saved WiFi...":"Подключение к сохранённой сети...","Show":"Показать","Connected!":"Подключено!","Connection Failed":"Ошибка подключения","Save password for next time?":"Сохранить пароль?","Press OK to scan again":"Нажмите OK для повторного поиска","Join a Network":"Подключиться к сети","Create Hotspot":"Создать точку доступа","Connect to an existing WiFi network":"Подключение к существующей сети Wi-Fi","Create a WiFi network others can join":"Создать сеть Wi-Fi для подключения других","USB Transfer":"Передача по USB","Transfer books over the USB cable":"Передача книг через USB-кабель","Connect via USB, then use Calibre, DoubleCommander or TotalCommander to transfer books":"Подключите USB, затем используйте Calibre, DoubleCommander или TotalCommander для передачи книг","USB Drive":"USB-накопитель","Manage the SD card from your computer":"Управляйте SD-картой с компьютера","Preparing USB Drive...":"Подготовка USB-накопителя...","Connect this reader to your computer":"Подключите читалку к компьютеру","USB Drive Connected":"USB-накопитель подключён","This may take up to 30 seconds to connect":"Подключение может занять до 30 секунд","Eject the drive on your computer, or disconnect the cable to return Home.":"Извлеките накопитель на компьютере или отключите кабель для возврата домой.","USB Drive error. Disconnect the cable to return Home.":"Ошибка USB-накопителя. Отключите кабель для возврата домой.","Unable to start USB Drive. Press Back to return Home.":"Не удалось запустить USB-накопитель. Нажмите Назад для возврата домой.","Starting Hotspot...":"Запуск точки доступа...","Hotspot Mode":"Режим точки доступа","Connect your device to this WiFi network":"Подключите устройство к этой сети Wi-Fi","Open this URL in your browser":"Откройте этот адрес в браузере","or http://":"или http://","or scan QR code with your phone:":"или отсканируйте QR-код:","No signal":"Нет сигнала","Poor":"Плохо","Weak":"Слабо","Good":"Хорошо","Excellent":"Отлично","Calibre Wireless":"Calibre по Wi-Fi","* = Encrypted | + = Saved":"* = Защищена | + = Сохранена","MAC address:":"MAC-адрес:","Checking WiFi...":"Проверка Wi-Fi...","Enter WiFi Password":"Введите пароль Wi-Fi","Add hidden network...":"Добавить скрытую сеть...","Enter Network Name (SSID)":"Введите имя сети (SSID)","Saved password may be wrong":"Сохранённый пароль неверен?","to ":"к ","Receiving: ":"Получение:","Received: ":"Получено: ","Deleted: ":"Удалено:","1) Install CrossPoint Reader plugin":"1) Установите плагин CrossPoint Reader","2) Be on the same WiFi network":"2) Подключитесь к той же сети Wi-Fi","3) In Calibre: \"Send to device\"":"3) В Calibre выберите: «Отправить на устройство»","\"Keep this screen open while sending\"":"Не закрывайте этот экран во время отправки","Reader":"Чтение","Controls":"Управление","System":"Система","Sleep Screen":"Экран сна","Quick Resume":"Быстрое возобновление","Quick Resume on Timeout":"Возобновление по таймауту","Sleep Screen Cover Mode":"Режим обложки сна","Hide Battery %":"Скрыть % батареи","Extra Paragraph Spacing":"Доп. интервал абзаца","Text Anti-Aliasing":"Сглаживание текста","Text Darkness":"Насыщенность текста","Extra Dark":"Очень тёмный","Maximum":"Максимум","Lighter":"Светлее","Images":"Изображения","Placeholder":"Заглушки","Suppress":"Скрыть","Placeholder for large images":"Заглушка для больших изображений","Large Image":"Большое изображение","Press Confirm to load":"Нажмите Подтв. для загрузки","Diffused Bayer":"Диффузный Bayer","Create fallback for invalid TOC":"Создать запасное оглавление","Reading Orientation":"Ориентация чтения","EPUB Font Family":"Шрифт чтения","Font Manager":"Менеджер шрифтов","Font installed!":"Шрифт установлен!","Font installation failed":"Не удалось установить шрифт","EPUB Font Size":"Размер шрифта EPUB","TXT/MD Font Family":"Шрифт TXT/MD","TXT/MD Font Size":"Размер шрифта TXT/MD","Reader Line Spacing":"Межстрочный интервал","Reader Screen Margin":"Поля экрана","Screen Edge Margin":"Отступ от края экрана","Reader Paragraph Alignment":"Выравнивание абзаца","Hyphenation":"Перенос слов","Normalize font size":"Нормализовать размер шрифта","Time to Sleep":"Сон через","File Visibility":"Видимость файлов","Show Hidden Files":"Показать скрытые файлы","Show File Extensions":"Показать расширения файлов","Sort By":"Сортировать по","Sort Direction":"Направление сортировки","Name":"Имени","Date":"Дате","Type":"Типу","Ascending":"По возрастанию","Descending":"По убыванию","Use Clock":"Показывать часы","Use Weather":"Использовать погоду","Clock Settings":"Настройки часов","Uses more battery":"Требует больше батареи","Clock may drift":"Часы могут сбиться","Clock":"Часы","Clock Format":"Формат времени","Clock Position":"Положение часов","Timezone":"Часовой пояс","NTP Server":"NTP-сервер","24h":"24 ч","12h":"12 ч","Sync Time":"Синхронизировать время","Detect Timezone":"Определить часовой пояс","Syncing clock...":"Синхронизация часов...","Detecting timezone...":"Определение часового пояса...","Time synced":"Время синхронизировано","Time sync failed":"Ошибка синхронизации времени","Drift: %s":"Отклонение: %s","Last sync: %s":"Посл. синхр.: %s","Timezone detected":"Часовой пояс определён","Timezone detect failed":"Не удалось определить часовой пояс","DST: active":"Летнее время: вкл","DST: inactive":"Летнее время: выкл","DST: unknown":"Летнее время: неизвестно","Refresh Frequency":"Частота обновления","Refresh after image pages":"Обновлять после страниц с изображениями","KOReader Sync":"Синхронизация KOReader","Sync":"Синхр.","System Update":"Обновление системы","X4Libris Updates":"Обновления X4Libris","Check for updates":"Проверить обновления","Alternative Firmware Updates":"Альтернативные обновления прошивки","Include beta updates":"Включить бета-обновления","Skip HTTPS validation (risky)":"Пропускать проверку HTTPS (рискованно)","Language":"Язык","Keyboard Layouts":"Раскладки клавиатуры","Clear Reading Cache":"Очистить кэш чтения","Username":"Имя пользователя","Password":"Пароль","Sync Server URL":"URL сервера синхронизации","Document Matching":"Сопоставление","Authenticate":"Авторизация","KOReader Username":"Имя пользователя KOReader","KOReader Password":"Пароль KOReader","Filename":"Имя файла","Binary":"Бинарный","Sync Behavior":"Поведение синхронизации","On Progress Conflict":"При конфликте прогресса","Ask every time":"Спрашивать каждый раз","Use furthest":"Использовать дальнюю","Auto-Push After":"Авто-отправка после","On Wake":"При пробуждении","On Sleep":"При переходе в сон","While Reading":"Во время чтения","On Closing a Book":"При закрытии книги","Automatic Sync":"Автосинхронизация","Receive":"Получение","Send":"Отправка","Finishing background sync...":"Завершение фоновой синхронизации...","Show Sync Indicator":"Показывать индикатор синхронизации","Status Bar":"Строка состояния","Send Document Metadata":"Отправлять метаданные","Set credentials first":"Укажите данные","WiFi connection failed":"Не удалось подключиться к Wi-Fi","WiFi lost, reconnecting...":"Нет Wi-Fi, переподключение...","Authenticating...":"Авторизация...","Successfully authenticated!":"Авторизация успешна!","KOReader Auth":"Авторизация KOReader","KOReader sync is ready to use":"Синхронизация KOReader готова","Authentication failed":"Ошибка авторизации","Register":"Регистрация","Registering...":"Регистрация...","Account created successfully!":"Аккаунт создан!","Registration failed":"Ошибка регистрации","Username already taken":"Имя пользователя уже занято","Done":"Готово","Installed":"Установлен","Download All":"Загрузить всё","Update All":"Обновить всё","This will clear all cached book data.":"Будут удалены все данные кэша книг.","All reading progress will be lost!":"Весь прогресс чтения будет потерян!","Books will need to be re-indexed":"Книги потребуется переиндексировать","when opened again.":"при повторном открытии.","Clearing cache...":"Очистка кэша...","Cache cleared":"Кэш очищен","items removed":"элементов удалено","failed":"ошибка","Failed to clear cache":"Не удалось очистить кэш","Check serial output for details":"Проверьте вывод по UART для деталей","Dark":"Тёмный","Light":"Светлый","Custom":"Свой","Cover":"Обложка","None":"Нет","Fit":"Вписать","Crop":"Обрезать","Never":"Никогда","In Reader":"В режиме чтения","Always":"Всегда","Portrait":"Книжная","Landscape CW":"Альбомная","Inverted":"Инверсия","Landscape CCW":"Альбомная 180°","Narrow":"Узкий","Medium":"Средний","Large":"Большой","Tight":"Узкий","Normal":"Обычный","Wide":"Широкий","Justify":"По ширине","Center":"По центру","Checking for update...":"Проверка обновлений...","New update available!":"Доступно новое обновление!","Current Version: ":"Текущая версия: ","New Version: ":"Новая версия: ","Updating...":"Обновление...","No update available":"Обновлений нет","Update failed":"Ошибка обновления","Release metadata too large":"Метаданные релиза слишком большие","Update complete":"Обновление завершено","Press and hold power button to turn back on":"Удерживайте кнопку питания для включения","Restarting... If device does not restart, hold the power button for a few seconds.":"Перезагрузка... Если устройство не перезагрузится, удерживайте кнопку питания несколько секунд.","No entries found":"Записи не найдены","Downloading...":"Загрузка...","Download failed":"Ошибка загрузки","No fonts available":"Шрифты недоступны","Error:":"Ошибка:","Unnamed":"Без имени","No server URL configured":"URL сервера не настроен","Failed to fetch feed":"Не удалось получить ленту","Failed to parse feed":"Не удалось обработать ленту","Next Page »":"Следующая страница »","« Previous Page":"« Предыдущая страница","Next":"Далее","Prev":"Назад","Search":"Поиск","Clear search":"Сбросить поиск","Search all folders":"Искать во всех папках","Go to folder":"Перейти в папку","Searching...":"Поиск...","Network: ":"Сеть: ","IP Address: ":"IP-адрес: ","Error: General failure":"Ошибка: Общая ошибка","Error: Network not found":"Ошибка: Сеть не найдена","Error: Connection timeout":"Ошибка: Тайм-аут соединения","SD card":"SD-карта","« Back":"« Назад","« Exit":"« Выход","« Home":"« Главная","Select":"Выбрать","Selected":"Выбран","Toggle":"Выбор","Confirm":"Подтвердить","Cancel":"Отмена","Repair Screen":"Очистка экрана","Clears ghosting left behind by fast page refreshes. The screen will flash black and white for about 20 seconds. Nothing is deleted.":"Убирает следы, оставленные быстрым обновлением страниц. Экран будет мигать чёрным и белым около 20 секунд. Ничего не удаляется.","Repairing screen...":"Очистка экрана…","Screen repaired":"Экран очищен","Start":"Запустить","Connect":"Подкл.","Open":"Открыть","Download":"Скачать","Retry":"Повторить","Resume":"Продолжить","Yes":"Да","No":"Нет","Hide":"Скрыть","ON":"ВКЛ","OFF":"ВЫКЛ","Not Set":"Не установлено","Up":"Вверх","Down":"Вниз","Up / Tab":"Вверх / Вкладка","Down / Tab":"Вниз / Вкладка","« Page":"« Стр.","Page »":"Стр. »","» / Options":"» / Параметры","Sleep Screen Cover Filter":"Фильтр экрана сна","Contrast":"Контраст","Adaptive":"Адаптивный","Equalize":"Выравнивание","Tilt Page Turn":"Перелистывание наклоном","Touch Page Turn":"Листание касанием","Tap Zones":"Зоны касания","Swipe":"Свайп","Tap Zones (Inverted)":"Зоны касания (инверсия)","Customise Status Bar":"Настройка строки состояния","Chapter Page Count":"Количество страниц главы","Book Page Count":"Текущая страница / всего в книге","Printed Page Number":"Номер печатной страницы","Book Progress Percentage":"% прочтения книги","Upper Progress Bar":"Верхняя шкала прогресса","Upper Progress Bar Thickness":"Толщина верхней шкалы прогресса","Lower Progress Bar":"Нижняя шкала прогресса","Lower Progress Bar Thickness":"Толщина нижней шкалы прогресса","Status Items Position":"Положение элементов статуса","Status Bar Font Size":"Размер шрифта строки состояния","Thin":"Тонкий","Thick":"Толстый","Book":"Книга","Chapter":"Глава","Chapter 21":"Глава 21","Book Title":"Название книги","Preview":"Предпросмотр","Battery":"Батарея","Top":"Верх","Bottom":"Низ","UI Font Size":"Размер шрифта интерфейса","UI Theme":"Тема интерфейса","Classic":"Классическая","Lyra Carousel":"Lyra Карусель","Sunlight Fading Fix":"Компенсация выцветания","Remap Front Buttons":"Переназначить передние кнопки","OPDS Browser":"OPDS браузер","Cover + Custom":"Обложка + Свой","Page overlay":"Наложение на страницу","Recent Books":"Недавние книги","No recent books":"Нет недавних книг","Unknown author":"Неизвестный автор","Library":"Библиотека","Books":"Книги","Recent":"Недавние","Authors":"Авторы","No new books":"Нет новых книг","Refresh library":"Обновить библиотеку","Not yet indexed":"Ещё не проиндексировано","Bookmarks":"Закладки","No bookmarks yet":"Пока нет закладок","Use Calibre wireless device transfers":"Использовать беспроводную передачу Calibre","Download books from an online catalog":"Загрузка книг из онлайн-каталога","Forget network and remove saved password?":"Забыть сеть и удалить сохранённый пароль?","Forget":"Забыть","Network Options":"Параметры сети","Reset info":"Сбросить данные","Clear cached IP and DNS; re-fetch on next connect. Keeps saved password.":"Очистить кэш IP и DNS; получить заново при следующем подключении. Сохраняет пароль.","Starting Calibre...":"Запуск Calibre...","Setup":"Настройка","Status":"Статус","Clear":"Очистить","Default":"По умолчанию","Press a front button for each role":"Назначьте роль для каждой кнопки","Unassigned":"Не назначено","Already assigned":"Уже назначено","Side button Up: Reset to default layout":"Боковая кнопка вверх: сбросить по умолчанию","Side button Down: Cancel remapping":"Боковая кнопка вниз: отменить переназначение","Back (1st button)":"Назад (1-я кнопка)","Confirm (2nd button)":"Подтвердить (2-я кнопка)","Left (3rd button)":"Влево (3-я кнопка)","Right (4th button)":"Вправо (4-я кнопка)","Go to %":"Перейти к %","Go to printed page":"Перейти к печатной странице","Range: %u - %u":"Диапазон: %u - %u","Up/Down: ±1 (x2: ±10)  Left/Right: digit":"Вверх/Вниз: ±1 (x2: ±10)  Влево/Вправо: цифра","Go Home":"На главную","Push progress from this device":"Отправить прогресс с этого устройства","Pull progress from other devices":"Получить прогресс с других устройств","Compare progress with other devices":"Сравнить прогресс с другими устройствами","Delete Book Cache":"Удалить кэш книги","Delete":"Удалить","Remove":"Удалить","Remove from recents":"Убрать из недавних","Delete?":"Удалить?","Delete book cache?":"Удалить кэш книги?","Remove from recents?":"Убрать из недавних?","Delete this folder and everything in it?":"Удалить эту папку со всем её содержимым?","Show page as QR":"Показать страницу в виде QR-кода","Mark as read":"Отметить как прочитанное","Fetch Progress & Open":"Получить прогресс и открыть","Chapter: ":"Глава: "," pages  |  ":" стр. | ","Book: ":"Книга: ","For Calibre, add /opds to your URL":"Для Calibre добавьте /opds к URL","Left/Right: 1%  Up/Down: 10%":"Влево/Вправо: 1%  Вверх/Вниз: 10%","Left/Right: 1  Up/Down: 10":"Влево/Вправо: 1  Вверх/Вниз: 10"," min":" мин"," pages":" стр.","Syncing time...":"Синхронизация времени...","Calculating document hash...":"Расчёт хэша документа...","Failed to calculate document hash":"Не удалось вычислить хэш документа","Fetching remote progress...":"Получение удалённого прогресса...","Mapping remote position...":"Сопоставление удалённой позиции...","Calculating local position...":"Вычисление локальной позиции...","Uploading progress...":"Отправка прогресса...","No credentials configured":"Данные для входа не настроены","Set up KOReader account in Settings":"Настройте аккаунт KOReader в настройках","Progress found!":"Прогресс найден!","Remote:":"Удалённый:","Local:":"Локальный:","Page %d, %.2f%% overall":"Страница %d, %.2f%% всего","Page %d/%d, %.2f%% overall":"Страница %d/%d","  From: %s":"  От: %s","Apply remote progress":"Применить удалённый прогресс","Upload local progress":"Отправить локальный прогресс","No remote progress found":"Удалённый прогресс не найден","Upload current position?":"Отправить текущую позицию?","Progress uploaded!":"Прогресс отправлен!","Already in sync":"Уже синхронизировано","Remote progress applied!":"Удалённый прогресс применён!","Sync failed":"Ошибка синхронизации","Section ":"Раздел ","Upload":"Отправить","Book's Style":"Как в книге","Embedded Style":"Встроенный стиль","OPDS Server URL":"URL OPDS сервера","No footnotes on this page":"На данной странице нет примечаний","[link]":"[ссылка]","Take screenshot":"Сделать снимок экрана","Add Server":"Добавить сервер","Server Name":"Имя сервера","No OPDS servers configured":"Нет настроенных серверов OPDS","Delete Server":"Удалить сервер","OPDS Servers":"Серверы OPDS","Download folder":"Папка для загрузок","Filename format":"Формат имени файла","Author - Title":"Автор - Название","Title - Author":"Название - Автор","SD root":"Корень SD","Auto Turn Enabled: ":"Автоперелистывание: ","Auto Turn (Pages Per Minute)":"Автолистание (стр./мин)","Render Benchmark":"Тест рендеринга","Weather":"Погода","Location":"Местоположение","OpenWeather API Key":"Ключ OpenWeather","Units":"Единицы","No location set for weather":"Местоположение не задано","Failed to fetch weather":"Ошибка загрузки погоды","Weather Settings":"Настройки погоды","Refresh":"Обновить","Feels like":"Ощущается","Humidity":"Влажность","Wind":"Ветер","Precip.":"Осадки","Precipitation Unit":"Единица осадков","Wind Speed Unit":"Единица скорости ветра","Temperature Unit":"Единица температуры","48-Hour Forecast":"Прогноз на 48 ч","Search City":"Поиск города","Longitude":"Долгота","Latitude":"Широта","Search Results":"Результаты поиска","Mon":"Пн","Tue":"Вт","Wed":"Ср","Thu":"Чт","Fri":"Пт","Sat":"Сб","Jan":"Янв","Feb":"Фев","Mar":"Мар","Apr":"Апр","May":"Май","Jun":"Июн","Jul":"Июл","Aug":"Авг","Sep":"Сен","Oct":"Окт","Nov":"Ноя","Dec":"Дек","New Moon":"Новолуние","Waxing Crescent":"Растущий серп","First Quarter":"Первая четверть","Waxing Gibbous":"Растущая луна","Full Moon":"Полнолуние","Waning Gibbous":"Убывающая луна","Last Quarter":"Последняя четверть","Waning Crescent":"Убывающий серп","Clear sky":"Ясно","Mainly clear":"Преимущественно ясно","Partly cloudy":"Переменная облачность","Overcast":"Пасмурно","Fog":"Туман","Rime fog":"Изморозь","Light drizzle":"Лёгкая морось","Drizzle":"Морось","Dense drizzle":"Сильная морось","Freezing drizzle":"Ледяная морось","Dense freezing drizzle":"Сильная ледяная морось","Slight rain":"Небольшой дождь","Moderate rain":"Умеренный дождь","Heavy rain":"Сильный дождь","Freezing rain":"Ледяной дождь","Heavy freezing rain":"Сильный ледяной дождь","Slight snow":"Небольшой снег","Moderate snow":"Умеренный снег","Heavy snow":"Сильный снег","Snow grains":"Снежная крупа","Slight showers":"Небольшие ливни","Moderate showers":"Умеренные ливни","Violent showers":"Сильные ливни","Snow showers":"Снежные ливни","Heavy snow showers":"Сильные снежные ливни","Thunderstorm":"Гроза","Thunderstorm, hail":"Гроза с градом","Thunderstorm, heavy hail":"Гроза с сильным градом","Unknown":"Неизвестно","Info":"Инфо","Sleep Screen Info Overlay":"Инфо на экране сна","Sleep Image Selection":"Выбор изображения сна","Random":"Случайный","Sequential":"Последовательный","White":"Белый","Gray":"Серый","Black":"Чёрный","Reading progress: Page %lu/%u - %.0f%%":"Прогресс: Стр. %lu/%u - %.0f%%","Reading progress: Page %lu":"Прогресс: Стр. %lu"," - Page %d/%d - %.0f%% read":" - Стр. %d/%d - %.0f%%","System Information":"Информация о системе","Reading Stats":"Статистика чтения","Total time":"Общее время","Sessions":"Сеансы","Pages turned":"Перевёрнуто страниц","Books tracked":"Книг отслежено","This session":"Этот сеанс","No reading recorded yet":"Чтение ещё не записано","Top books":"Лучшие книги","Streak":"Серия","Last 30 days":"Последние 30 дней","All books":"Все книги","First read":"Первое чтение","Avg session":"Средний сеанс","Progress":"Прогресс","Last read":"Последнее чтение","Reading stats":"Статистика чтения","Book info":"Информация о книге","Longest":"Самая длинная","Pages/min":"Страниц/мин","History":"История","Last finished":"Последнее завершение","Remove from reading stats?":"Удалить из статистики чтения?","Read %s":"Чтение: %s","over 1 day":"за 1 день","over %u days":"за %u дн.","last %s":"последний раз %s","Time to finish":"Время до конца","Failed to load XTC file":"Ошибка загрузки файла XTC","Failed to load EPUB file":"Ошибка загрузки файла EPUB","FW version":"Версия ПО","Display SDK":"SDK дисплея","Panel controller":"Контроллер панели","Chip":"Чип","MHz":"МГц","Uptime":"Время работы","Light sleep":"Лёгкий сон","Declined":"Отклонено","Deep sleep":"Глубокий сон","Version":"Версия","Memory":"Память","Runtime":"Время работы","Storage":"Хранилище","Free / Min / Max":"Свободно / Мин / Макс","Device":"Устройство","App partition":"Раздел приложения","Total flash":"Всего Flash","Font cache":"Кэш шрифтов","Charging":"Зарядка","Gathering data...":"Сбор данных...","Reading...":"Чтение...","Press Update to load SD info":"Нажмите обновить","Unsupported image format":"Формат изображения не поддерживается","Could not render image":"Не удалось отобразить изображение","Failed to set sleep screen":"Не удалось установить экран сна","Set Sleep":"Установить экран сна","Sleep screen updated!":"Экран сна обновлён!",">> B&W":">> Ч/Б",">> Gray":">> Оттенки серого","Quick Overrides":"Быстрые настройки","Tools":"Инструменты","Navigation":"Навигация","Network":"Сеть","Battery symbol":"Значок батареи","Screen refresh":"Обновление экрана","Appearance":"Оформление","Screen parameters":"Параметры экрана","Reader Font":"Шрифт чтения","TXT/MD Font":"Шрифт TXT/MD","Layout Settings":"Макет","Reader Tweaks":"Параметры чтения","Spacing":"Интервал","Server Settings":"Настройки сервера","Login / Register":"Вход / Регистрация","Starred Pages":"Отмеченные страницы","No starred pages":"Нет отмеченных страниц","Rename":"Переименовать","p":"с","Login Required":"Требуется вход","Network requires browser login. On another device,":"Сеть требует входа через браузер. На другом устройстве,","visit the URL below to authorize, then press OK.":"перейдите по указанному ниже URL, чтобы авторизоваться, затем нажмите OK.","I'm authorized":"Я авторизован","Button Actions":"Действия кнопок","Physical Buttons":"Физические кнопки","Button Actions Overview":"Обзор действий кнопок","Button":"Кнопка","Short":"Короткое","Double":"Двойное","Long":"Долгое","Short Press":"Короткое нажатие","Double Press":"Двойное нажатие","Long Press":"Долгое нажатие","Back Button":"Кнопка Назад","Confirm Button":"Кнопка Подтвердить","Left Button":"Кнопка Влево","Right Button":"Кнопка Вправо","Up Button":"Кнопка Страница назад","Down Button":"Кнопка Страница вперед","Power Button":"Кнопка питания","Ignore":"Игнорировать","Exit Reader":"Выйти из ридера","Reader Menu":"Меню ридера","Previous Page":"Предыдущая страница","Next Page":"Следующая страница","Chapter Back":"Глава назад","Chapter Forward":"Глава вперед","Sleep":"Сон","Nothing":"Ничего","Skip 10 Pages Forward":"Пропустить 10 страниц вперед","Skip 10 Pages Back":"Пропустить 10 страниц назад","Refresh Screen":"Обновить экран","Fast Refresh Screen":"Быстро обновить экран","Open Table of Contents":"Открыть оглавление","Open Bookmarks":"Открыть закладки","Next Section / Chapter":"Следующий раздел / глава","Previous Section / Chapter":"Предыдущий раздел / глава","Press LEFT or RIGHT to move cursor":"Нажмите ВЛЕВО/ВПРАВО для перемещения курсора","Press LEFT to return to cursor position":"Нажмите ВЛЕВО для возврата к курсору","Hold RIGHT then press [***] to hide password":"Удерживайте ВПРАВО + [***], чтобы скрыть пароль","Hold RIGHT then press [abc] to show password":"Удерживайте ВПРАВО + [abc], чтобы показать пароль","Press [***] to hide password":"Нажмите [***], чтобы скрыть пароль","Press [abc] to show password":"Нажмите [abc], чтобы показать пароль","Hold UP to edit entry":"Удерживайте ВВЕРХ для редактирования записи","Tips:":"Подсказки:","Press DOWN to return to keyboard":"Нажмите ВНИЗ, чтобы вернуться к клавиатуре","Press ABC to exit URL mode":"Нажмите ABC для выхода из режима URL","Hold DEL to clear all text":"Удерживайте <—, чтобы очистить весь текст","Hold SELECT for secondary char":"Удерживайте ВЫБРАТЬ для доп. символов","Hold SELECT for UPPERCASE or secondary char":"Удерживайте ВЫБРАТЬ для ЗАГЛАВНЫХ / символов","Hold SELECT for lowercase or secondary char":"Удерживайте ВЫБРАТЬ для строчных / символов","Press URL for snippets":"Нажмите URL для выбора шаблонов","Bionic Reading":"Бионическое чтение","Guide Dots":"Направляющие точки","Inline Footnote Previews":"Встроенный предпросмотр примечаний","Reading Aids":"Средства чтения","Toggle Bionic Reading":"Переключить бионическое чтение","Change Font Size":"Изменить размер шрифта","Change Orientation":"Изменить ориентацию","Ignore (do nothing)":"Игнорировать (ничего не делать)","SD Card Firmware Update":"Обновление прошивки с SD-карты","All Files":"Все файлы","Switch to USB Drive Mode":"Перейти в режим USB-накопителя","The device will restart in USB drive mode.":"Устройство перезапустится в режиме USB-накопителя.","Restart":"Перезагрузить","Select firmware file (.bin)":"Выберите файл прошивки (.bin)","No .bin files found":".bin файлы не найдены","Validating firmware...":"Проверка файла прошивки...","Invalid firmware file":"Неподходящий файл прошивки","Firmware too large for partition":"Прошивка не помещается в раздел","Firmware file is too small":"Файл прошивки слишком мал","Firmware is for a different device":"Несовместимая прошивка","Update firmware?":"Обновить прошивку?","Cannot open file":"Не удалось открыть файл","Firmware write failed":"Ошибка записи прошивки","Do not power off!":"Не выключайте питание!","Recovery Mode":"Режим восстановления","Place firmware.bin on SD card root and select it":"Поместите firmware.bin в корень SD-карты и выберите его","Book view":"Вид книг","Filenames":"Имена файлов","Details":"Подробно","Covers":"Обложки","book":"книга","books":"книг","Finished":"Прочитано","Utilities":"Утилиты","Dictionary":"Словарь","Look Up":"Поиск","Looking up...":"Поиск...","Indexing dictionary...":"Индексация словаря...","Not found":"Не найдено","No dictionary set":"Словарь не выбран","Dictionary error":"Ошибка словаря","Couldn't read definition":"Определение не прочитано","Couldn't decompress definition":"Определение не распаковано","Not enough memory":"Недостаточно памяти","Boot Diagnostics":"Диагностика загрузки","Font Scaling Test":"Тест масштабирования шрифтов","This boot":"Эта загрузка","Last sleep":"Последний сон","History (newest first)":"История (сначала новые)","Reset reason":"Причина сброса","Wake cause":"Причина пробуждения","Wake gate":"Проверка пробуждения","Boot phases":"Этапы загрузки","To first paint":"До первой отрисовки","Stopped at":"Остановлено на","Trigger":"Источник","Battery latch":"Фиксация батареи","Release wait":"Ожидание отпускания","kept (MCU stays powered)":"сохранена (MCU остаётся под питанием)","cut (powers off)":"снята (выключается)","reached deep sleep":"глубокий сон достигнут","NEVER REACHED DEEP SLEEP":"ГЛУБОКИЙ СОН НЕ ДОСТИГНУТ","No records yet":"Записей пока нет","unknown":"неизвестно","no boot recorded after this sleep":"после этого сна загрузка не записана","powered off as asked (a reset looks the same)":"выключено по запросу (сброс выглядит так же)","powered off although the clock was kept alive":"выключено, хотя часы должны были работать","STUCK: button never released, slept anyway":"ЗАВИСАНИЕ: кнопка не отпущена, сон всё равно","Previous session":"Предыдущий сеанс","ended without sleeping (reset or crash)":"завершён без сна (сброс или сбой)","ended at the sleep path":"завершён на пути ухода в сон","Hardware variant":"Вариант оборудования","Board profile":"Профиль платы","Panel probe":"Определение панели","Aborted boots":"Прерванные загрузки","none":"нет","woke and refused to start":"проснулось и отказалось запускаться","ever recorded":"записано всего","counted but not yet filed":"подсчитано, но ещё не записано","Reading Light":"Подсветка","Brightness":"Яркость","Warmth":"Теплота","Restore Light on Wake":"Подсветка при пробуждении","Reading light":"Подсветка","Home screen":"Главный экран","User interface":"Интерфейс","More":"Ещё","Toggle Reading Light":"Переключить подсветку","Light Brighter":"Ярче","Light Dimmer":"Тусклее","Light Warmer":"Теплее","Light Cooler":"Холоднее","Gesture actions":"Действия жестов","Gesture overview":"Обзор жестов","Tap / hold zones":"Зоны касания и удержания","bold = tap, below = hold":"жирный = касание, ниже = удержание","bold = swipe up, then down, then sideways":"жирный = вверх, затем вниз, затем вбок","Swipe zones":"Зоны свайпов","Swipe left":"Свайп влево","Swipe right":"Свайп вправо","Swipe up, left edge":"Свайп вверх, левый край","Swipe up, right edge":"Свайп вверх, правый край","Swipe down, left edge":"Свайп вниз, левый край","Swipe down, right edge":"Свайп вниз, правый край","Swipe sideways, left zone":"Свайп вбок, левая зона","Swipe sideways, right zone":"Свайп вбок, правая зона","Tap left":"Касание слева","Tap right":"Касание справа","Tap centre":"Касание по центру","Tap top":"Касание сверху","Tap bottom":"Касание снизу","Long tap left":"Долгое касание слева","Long tap right":"Долгое касание справа","Long tap centre":"Долгое касание по центру","Long tap top":"Долгое касание сверху","Long tap bottom":"Долгое касание снизу","Long tap top-left corner":"Долгое касание, верхний левый угол","Long tap top-right corner":"Долгое касание, верхний правый угол","Long tap bottom-left corner":"Долгое касание, нижний левый угол","Long tap bottom-right corner":"Долгое касание, нижний правый угол","Pinch in":"Сведение пальцев","Pinch out":"Разведение пальцев","Rotate clockwise":"Поворот по часовой стрелке","Rotate counter-clockwise":"Поворот против часовой стрелки","Tap":"Касание","Long tap":"Долгое касание","Two fingers":"Два пальца","Smaller Text":"Мельче текст","Larger Text":"Крупнее текст","Toggle Touch Navigation":"Переключить сенсорную навигацию","Change Orientation Back":"Ориентация назад","Touch Navigation":"Сенсорная навигация","On":"Вкл.","Tap Action":"Действие касания","Select, then activate":"Выбрать, затем открыть","Activate immediately":"Открывать сразу","Everyone has the right to freedom of thought, conscience and religion.":"Каждый человек имеет право на свободу мысли, совести и религии.","Creating font preview %u/%u":"Создание образца %u/%u","New Folder":"Новая папка","Folder name":"Имя папки","Could not create that folder":"Не удалось создать папку","Move to folder":"Переместить в папку","Move":"Переместить","Move failed":"Не удалось переместить","A file of that name is already there":"Там уже есть файл с таким именем","It is already in that folder":"Файл уже в этой папке","Show Busy Indicator":"Показывать индикатор ожидания","Line spacing scale (%)":"Межстрочный масштаб, %","Custom first-line indent":"Свой отступ первой строки","First-line indent (% of font)":"Отступ, % размера шрифта","Extra paragraph gap (% of line)":"Интервал абзацев, % строки","Reader button timing":"Время нажатий в чтении","Button hold duration":"Длительность удержания","Button double-press interval":"Интервал двойного нажатия","Tap zone sizes":"Размеры зон тапов","Left width, % (0 = auto)":"Левая зона, % (0 = авто)","Right width, % (0 = auto)":"Правая зона, % (0 = авто)","Top height, % (0 = auto)":"Верхняя зона, % (0 = авто)","Bottom height, % (0 = auto)":"Нижняя зона, % (0 = авто)","Hold corner size, % (0 = auto)":"Угол удержания, % (0 = авто)","Trial firmware":"Пробный запуск","After 5 seconds: Up keeps, Down rolls back. Or tap the screen. No confirmation: rollback 180 seconds after boot.":"Через 5 секунд: Up — оставить, Down — откатить. Можно нажать на экран. Без подтверждения откат через 180 секунд от включения.","Previous valid firmware not found. Acceptance is blocked.":"Рабочая предыдущая прошивка не найдена. Подтверждение заблокировано.","Roll back":"Откатить","Keep firmware":"Оставить","Override book formatting":"Переопределять оформление книги","Book style (overrides off)":"Стиль книги (переопределение выкл.)","Heading alignment":"Выравнивание заголовков","All reader settings":"Все настройки чтения","Quick settings":"Быстрые настройки","Apply to":"Применять к","This book":"Эта книга","Global settings":"Общие настройки","Font and size":"Шрифт и размер","Paragraphs and spacing":"Абзацы и интервалы","Headings":"Заголовки","Margins and orientation":"Поля и положение","More options":"Дополнительно","Orientation (all books)":"Положение (все книги)","Heading size":"Размер заголовков","Level 2 heading size":"Размер заголовков 2 уровня","Follow general":"Как для остальных","Calendar":"Календарь","Set the device date and time to show the calendar":"Установите дату и время устройства","Chess":"Шахматы","Applications folder":"Папка приложений","Wikipedia":"Википедия","RSS feeds":"RSS-ленты","Notes":"Заметки","Today":"Сегодня","+ Add task":"+ Добавить задачу","No tasks for today":"На сегодня задач нет","Clear completed":"Удалить выполненные","Show Today on sleep screen":"Показывать сегодня при сне","Remove Today from sleep screen":"Убрать со страницы сна","Sudoku":"Судоку","Dice":"Кости","Note":"Заметка","New note":"Новая заметка","Edit text":"Изменить текст","Add line":"Добавить строку","Note title":"Название заметки","Note text":"Текст заметки","New game":"Новая игра","The device is thinking...":"Устройство думает...","Checkmate":"Мат","Draw":"Ничья","Your turn (White)":"Ваш ход (белые)","Device turn (Black)":"Ход устройства (чёрные)","Tap a piece, then its destination. Buttons: navigate/select.":"Коснитесь фигуры, затем клетки хода. Кнопки: выбор.","Week %d":"Неделя %d","Week number":"Номер недели","Week starts on":"Начало недели","October":"Октябрь","November":"Ноябрь","December":"Декабрь","January":"Январь","February":"Февраль","March":"Март","April":"Апрель","June":"Июнь","July":"Июль","August":"Август","September":"Сентябрь","Monday":"Понедельник","Tuesday":"Вторник","Wednesday":"Среда","Thursday":"Четверг","Friday":"Пятница","Saturday":"Суббота","Sunday":"Воскресенье","Book info on status bar tap":"Сведения о книге по нажатию строки состояния","Footnote preview on tap":"Предпросмотр сноски по нажатию","Author":"Автор","Current chapter":"Текущая глава","Files":"Файлы","Applications":"Приложения","General":"Общие","Screen":"Экран","Reading":"Чтение","Language, time, battery, system updates":"Язык, дата и время, питание, обновление системы","Theme, brightness, sleep screen":"Тема, яркость, ночной режим, экран сна","Font, text size, alignment, progress":"Шрифт, размер текста, выравнивание, прогресс","Touch, buttons, gestures, navigation":"Сенсор, кнопки, жесты, навигация","Scan books, view, sorting, covers":"Сканирование книг, вид, сортировка, обложки","Wi-Fi, USB, file transfer, online services":"Wi-Fi, USB, передача файлов, онлайн-службы"};
