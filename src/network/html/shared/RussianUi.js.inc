<script>
  <!--#include file="shared/RussianFirmwareText.js.inc" -->
  window.x4librisFirmwareRu = (value) => firmwareRuText[value] || value;
  window.x4librisFirmwareEn = (value) => Object.keys(firmwareRuText).find((english) => firmwareRuText[english] === value) || value;
  // The web pages can be opened from a device configured in any language. Keep the
  // browser interface Russian without changing API values, filenames or book metadata.
  (() => {
    const text = {
      'File Manager':'Файловый менеджер','Files':'Файлы','Upload':'Загрузить','New folder':'Новая папка',
      '📤 Upload file':'📤 Загрузить файл','📦 85% JPEG':'📦 JPEG, качество 85%','📦 JPEG Quality':'📦 Качество JPEG',
      '📱 Target Device':'📱 Целевое устройство','↻ Rotation Direction':'↻ Направление поворота','📐 Min Overlap':'📐 Минимальное перекрытие',
      'Find Duplicates':'Поиск дубликатов','Lists files that share an exact size, usually the same book stored twice. Reads only the folder listing and changes nothing.':'Показывает файлы одинакового размера, которые могут быть копиями одной книги. Только читает список файлов и ничего не меняет.',
      'Organize by Author':'Сортировка по авторам','Sorts the EPUBs of one folder into a folder per author, taking their cover and metadata files along. Shows a preview first.':'Сортирует EPUB-файлы по папкам авторов вместе с обложками и сведениями о книгах. Перед изменениями показывает предварительный просмотр.',
      '📥 Drop files to upload to':'📥 Перетащите файлы для загрузки в','⚠️ Some files failed to upload':'⚠️ Не удалось загрузить некоторые файлы',
      '⚫ True-Grayscale':'⚫ Настоящие оттенки серого','📏 Max 480×800px':'📏 Максимум 480×800 пикс.','🔧 Fix SVG':'🔧 Исправлять SVG',
      '🎨 Keep Cover in Color':'🎨 Сохранять цвет обложки','✂️ Split Long Chapters':'✂️ Разбивать длинные главы',
      '📥 Auto-download Log':'📥 Автоматически сохранять журнал','💾 Remember These Options':'💾 Запомнить параметры',
      '🖼️ Image Processing Options':'🖼️ Обработка изображений','⚠️ Converting will modify files and can break hash‑based sync. ⚠️':'⚠️ Преобразование изменит файлы и может нарушить синхронизацию по контрольной сумме. ⚠️',
      '📋 Conversion Log':'📋 Журнал преобразования','📁 New Folder':'📁 Новая папка','🗑️ Delete Item(s)':'🗑️ Удалить элементы',
      '⚠️ This action cannot be undone!':'⚠️ Это действие нельзя отменить!','⚠️ File Already Exists':'⚠️ Файл уже существует',
      '✏️ Rename File':'✏️ Переименовать файл','➡️ Move File':'➡️ Переместить файл','🖼️ Preview':'🖼️ Предпросмотр',
      'Optimize':'Оптимизировать','Move':'Переместить','Delete':'Удалить','Dismiss':'Закрыть',
      'Retry All Failed Uploads':'Повторить все неудачные загрузки','Contents':'Содержимое',
      'Some files failed to upload':'Не удалось загрузить некоторые файлы','Drop files to upload to':'Перетащите файлы для загрузки в',
      'Upload file':'Загрузить файл','Select a file to upload to':'Выберите файл для загрузки в',
      'Optimize EPUB':'Оптимизировать EPUB','Advanced Mode':'Расширенные настройки','True-Grayscale':'Настоящие оттенки серого',
      'Max 480×800px':'Макс. 480×800 пикс.','Fix SVG':'Исправлять SVG','JPEG Quality':'Качество JPEG',
      'Minimum quality':'Минимальное качество','Low quality':'Низкое качество','Medium-low quality':'Ниже среднего',
      'Medium quality':'Среднее качество','High quality':'Высокое качество','Maximum quality':'Максимальное качество',
      'BT.601 luminance formula (recommended for e-ink)':'Формула яркости BT.601 (рекомендуется для экранов E Ink)',
      'Target Device':'Целевое устройство','Auto':'Авто','Rotation Direction':'Направление поворота','Min Overlap':'Минимальное перекрытие',
      'Keep Cover in Color':'Сохранить обложку цветной','Only resized to fit the screen, not turned to grayscale':'Обложка только подгоняется под экран, без преобразования в оттенки серого',
      'Split Long Chapters':'Разбивать длинные главы','Over 8,000 words or 32 KB: several files, cut at headings or breaks':'Более 8 000 слов или 32 КБ: разделить на несколько файлов по заголовкам или разрывам',
      'Auto-download Log':'Автоматически сохранять журнал','Export detailed log with statistics':'Сохранять подробный журнал со статистикой',
      'Remember These Options':'Запомнить параметры','Saved in this browser for the next upload':'Параметры сохраняются в этом браузере для следующей загрузки',
      'Image Processing Options':'Обработка изображений','images':'изображений','Cover':'Обложка','Separator':'Разделитель',
      'Normal':'Обычное','H-Split':'Разделить по горизонтали','V-Split':'Разделить по вертикали','Rotate':'Повернуть',
      'Optimize & Upload':'Оптимизировать и загрузить','Cancel':'Отмена','Conversion Log':'Журнал преобразования',
      'New Folder':'Новая папка','Create a new folder in':'Создать папку в','Folder name...':'Имя папки…','Create Folder':'Создать папку',
      'Delete Item(s)':'Удалить элементы','This action cannot be undone!':'Это действие нельзя отменить!','Are you sure you want to delete the following item(s)?':'Удалить выбранные элементы?',
      'Optimize on the card':'Оптимизация на карте памяти','File Already Exists':'Файл уже существует','Replace':'Заменить','Keep both':'Оставить оба','Skip':'Пропустить',
      'Rename File':'Переименовать файл','Rename':'Переименовать','Renaming':'Переименование','New file name...':'Новое имя файла…',
      'Move File':'Переместить файл','Moving':'Перемещение','Preview':'Предпросмотр','Download':'Скачать','Download report':'Скачать отчёт',
      'Loading...':'Загрузка…','Loading…':'Загрузка…','Loading catalog...':'Загрузка каталога…','Catalog not loaded':'Каталог не загружен',
      'Waiting for action...':'Ожидание действия…','No remote fonts found':'В каталоге нет шрифтов','Refresh catalog':'Обновить каталог',
      'Download all updates':'Скачать все обновления','Download status':'Состояние загрузки','Font Manager':'Менеджер шрифтов',
      'On the reader':'На устройстве','Installed fonts':'Установленные шрифты','Add fonts':'Добавить шрифты','Download fonts':'Скачать шрифты',
      'Convert a font':'Преобразовать шрифт','Upload a font':'Загрузить шрифт','Convert from':'Источник шрифта','Font files':'Файлы шрифтов',
      'The fonts of an EPUB':'Шрифты из EPUB','An EPUB with embedded fonts':'EPUB со встроенными шрифтами','Details':'Сведения',
      'Convert its fonts':'Преобразовать его шрифты','Family name':'Название семейства','Letters, digits, - and _':'Буквы, цифры, - и _',
      'Characters':'Набор символов','Latin, Cyrillic and Greek':'Латиница, кириллица и греческий','Latin and Cyrillic':'Латиница и кириллица',
      'Sizes (points)':'Размеры (пункты)','Convert and install':'Преобразовать и установить','Upload a font':'Загрузить шрифт',
      'System Info':'Сведения о системе','What the reader reports about itself.':'Сведения, сообщаемые устройством.',
      'Version':'Версия','Firmware':'Прошивка','Device':'Устройство','Network':'Сеть','Wi-Fi':'Wi-Fi','IP address':'IP-адрес','MAC address':'MAC-адрес',
      'Runtime':'Работа устройства','Uptime':'Время работы','Battery':'Батарея','Storage':'Хранилище','SD card':'Карта памяти SD',
      'Not loaded':'Не загружено','Load SD info':'Загрузить сведения о карте SD','Chip':'Чип','CPU':'Процессор',
      'Memory and flash':'Память и флеш-память','Heap free / min / max':'Свободная память / минимум / максимум',
      'App partition':'Раздел приложения','Total flash':'Объём флеш-памяти','Open Diagnostics':'Открыть диагностику',
      'Fast fetch:':'Быстрый запрос:','Full fetch:':'Полный запрос:','Error':'Ошибка','Error loading':'Ошибка загрузки',
      'Diagnostics':'Диагностика','How the reader last slept and started, and a report to attach to a bug.':'Сведения о последнем переходе в сон и запуске устройства, а также отчёт для сообщения об ошибке.',
      'Bug report':'Отчёт об ошибке','Download report':'Скачать отчёт','Last sleep':'Последний переход в сон','This boot':'Текущий запуск',
      'Boot phases':'Этапы запуска','Time each step of starting up took. Steps the boot did not go through are left out.':'Длительность каждого этапа запуска. Этапы, которые не выполнялись, не показаны.',
      'Sleep and boot history':'История сна и запусков','Newest first.':'Сначала новые записи.','Sleep':'Сон','Boot':'Запуск','Aborted':'Прервано',
      'Device status':'Состояние устройства','Board profile':'Профиль платы','Panel controller':'Контроллер экрана','Panel probe':'Проверка экрана',
      'Heap free / lowest / largest block':'Свободная память / минимум / наибольший блок','Reset reason':'Причина сброса',
      'Previous session':'Предыдущий сеанс','Wake cause':'Причина пробуждения','Wake gate':'Проверка кнопки пробуждения',
      'Aborted boots':'Прерванные запуски','To first picture':'До первого изображения','Light sleep':'Лёгкий сон',
      'Step':'Этап','Took':'Длительность','Done at':'Завершён через','Verdict':'Результат','Stopped at':'Остановлено на',
      'Trigger':'Причина','Battery latch':'Питание батареи','Release wait':'Ожидание отпускания кнопки','No sleep recorded yet.':'Записей о переходе в сон пока нет.',
      'No records yet.':'Записей пока нет.','unknown (fewer than two records in the history)':'неизвестно (в истории меньше двух записей)',
      'ended at the sleep path':'завершился переходом в сон','ended without sleeping (reset or crash)':'завершился без перехода в сон (сброс или сбой)',
      'kept (the chip stays powered)':'сохранено (чип остаётся под питанием)','cut (powers off)':'отключено (питание снято)',
      'Reading Stats':'Статистика чтения','Time spent reading on this device, in total and per book. Open a book\'s row for its details.':'Общее время чтения на устройстве и по каждой книге. Откройте строку книги, чтобы посмотреть подробности.',
      'All time':'За всё время','Sessions':'Сеансы','Books':'Книги','Streak':'Серия дней','Longest':'Самая длинная серия',
      'Total time':'Общее время','Pages turned':'Перелистнуто страниц','Pages/min':'Страниц в минуту','Last 30 days':'Последние 30 дней',
      'No reading recorded yet. Open a book and read for a while — your stats will appear here.':'Пока нет данных о чтении. Откройте книгу и почитайте — статистика появится здесь.',
      'A book on the reader: open it with':'Книга на устройстве: откройте её через пункт',
      'No .ifo file: the dictionary works, but has no title or word count.':'Нет файла .ifo: словарь работает, но у него нет названия и числа слов.',
      'No .dict or .dict.dz file next to':'Нет файла .dict или .dict.dz рядом с',
      'No .idx index file.':'Нет индексного файла .idx.',
      'No .idx or .idx.gz file':'Нет файла .idx или .idx.gz',
      'The index is compressed (.idx.gz). The reader needs a plain .idx: install the dictionary again from this page, which unpacks it.':'Индекс сжат (.idx.gz). Устройству нужен обычный файл .idx. Установите словарь повторно с этой страницы — архив распакуется автоматически.',
      'The index file must end in lower-case ".idx".':'Расширение индексного файла должно быть написано строчными буквами: .idx.',
      'The reader skips folders whose name starts with a dot.':'Устройство пропускает папки, название которых начинается с точки.',
      'The reader does not support 64-bit index offsets (idxoffsetbits=64).':'Устройство не поддерживает 64-разрядные смещения индекса (idxoffsetbits=64).',
      'The reader skips the folder: give each its own folder.':'Устройство пропускает эту папку. Поместите каждый словарь в отдельную папку.',
      'The reader keeps only that many when you choose it, and then cannot find the folder: rename it.':'При выборе устройство учитывает только допустимую длину имени и затем не находит папку. Переименуйте её.',
      'Uses the compressed .dict.dz. It works, but a plain .dict needs no 32 KB inflate buffer per lookup, which a busy reading heap cannot always spare.':'Используется сжатый .dict.dz. Он работает, но обычному .dict не нужен буфер распаковки 32 КБ при каждом поиске — во время чтения свободной памяти может не хватить.',
      'The synonyms file is compressed (.syn.gz) and is ignored.':'Файл синонимов сжат (.syn.gz) и будет пропущен.',
      'A plain .dict needs no 32 KB inflate buffer per lookup, which the reader cannot always find while a book is open.':'Для обычного .dict не нужен буфер распаковки 32 КБ при каждом поиске, который устройству может быть трудно выделить при открытой книге.',
      'Minimum quality':'Минимальное качество','Low quality':'Низкое качество','Medium-low quality':'Ниже среднего','Medium quality':'Среднее качество','High quality':'Высокое качество','Maximum quality':'Максимальное качество',
      'File name cannot include slashes.':'В имени файла нельзя использовать косую черту.','File name cannot include slashes':'В имени файла нельзя использовать косую черту.',
      'or drop the files here':'или перетащите файлы сюда',
      'Delete failed':'Не удалось удалить','upload failed':'Не удалось загрузить','download failed':'Не удалось скачать','catalog unavailable':'Каталог недоступен',
      'The reader answered':'Устройство ответило','unknown error':'неизвестная ошибка','No reading':'Нет чтения',
      'Each book is downloaded, optimized in this browser with the options under Upload, Advanced Mode, and put back in its place.':'Каждая книга скачивается, оптимизируется в браузере с параметрами из разделов «Загрузка» и «Расширенные настройки», затем сохраняется на прежнее место.',
      'is already in':'уже находится в','Do the same for the other files that already exist':'Применить это действие и к остальным уже существующим файлам',
      'CCW':'Против часовой стрелки','CW':'По часовой стрелке','All rights reserved.':'Все права защищены.',
      'No books tracked yet.':'Пока нет книг со статистикой.','Title':'Название','Time':'Время','Progress':'Прогресс','To finish':'До завершения',
      'Last read':'Последнее чтение','Finished':'Завершена','Download backup':'Скачать резервную копию','Time to finish':'Время до завершения',
      'Author':'Автор','Avg session':'Средняя длительность сеанса','First read':'Первое чтение','Remove from stats':'Удалить из статистики',
      'Plugins':'Плагины','Plugins add cards to the File Manager or Settings page.':'Плагины добавляют карточки в файловый менеджер или настройки.',
      'Installed plugins':'Установленные плагины','Available plugins':'Доступные плагины','Install from a file':'Установить из файла',
      'Install':'Установить','No plugins installed. Install one from the catalog below, or from a .zip file.':'Плагины не установлены. Выберите плагин из каталога ниже или установите его из ZIP-файла.',
      'switched off':'выключен','Switch on':'Включить','Switch off':'Выключить','Remove':'Удалить','Installed':'Установлен',
      'Update':'Обновить','Reinstall':'Установить заново','By ':'Автор: ','Adds itself to: ':'Раздел: ','page':'страница',
      'The catalog is empty.':'Каталог пуст.','Dictionaries':'Словари','StarDict dictionaries for looking words up while you read.':'Словари StarDict для поиска слов во время чтения.',
      'Installed dictionaries':'Установленные словари','Install a dictionary':'Установить словарь','Ready':'Готов','Works':'Работает',
      'Not usable':'Не работает','Not usable':'Не работает','Remove':'Удалить','No dictionaries installed yet.':'Словари ещё не установлены.',
      'empty folder':'пустая папка','Folder':'Папка','Name':'Имя','Type':'Тип','Size':'Размер','Actions':'Действия','FOLDER':'ПАПКА',
      'File':'Файл','Folder name':'Имя папки','Settings':'Настройки','Changes reach the reader when you save them.':'Изменения применятся на устройстве после сохранения.',
      'Search settings':'Поиск по настройкам','Settings categories':'Разделы настроек','Loading':'Загрузка','Wi-Fi networks':'Сети Wi-Fi',
      'Networks the reader joins on its own. Passwords are never shown, only replaced or cleared.':'Сети, к которым устройство подключается автоматически. Сохранённые пароли не показываются: их можно заменить или удалить.',
      'OPDS servers':'Серверы OPDS','Online catalogs the reader can browse and download books from.':'Онлайн-каталоги, в которых можно искать и скачивать книги.',
      'Settings that installed plugins add to this page. Install, switch off or remove plugins on the':'Настройки, добавленные установленными плагинами. Устанавливать, отключать и удалять плагины можно на странице',
      'Plugins page.':'«Плагины».','No installed plugin adds settings here.':'Установленные плагины не добавляют сюда настройки.',
      'Unsaved changes':'Несохранённые изменения','Discard':'Отменить','Save changes':'Сохранить изменения','On the reader':'На устройстве',
      'Connections':'Подключения','Search':'Поиск','Unchanged - type to replace':'Не изменён — введите новый пароль для замены','Not set':'Не задан',
      'Clear the stored password':'Удалить сохранённый пароль','No setting matches':'Настройки не найдены','Saving...':'Сохранение…',
      'Settings saved.':'Настройки сохранены.','Enter the network name.':'Введите имя сети.','Network saved.':'Сеть сохранена.',
      'Network forgotten.':'Сеть удалена.','Last connected':'Последнее подключение','Network name (SSID)':'Имя сети (SSID)','Password':'Пароль',
      'Forget':'Забыть','Save':'Сохранить','+ Add a network':'+ Добавить сеть','No networks saved yet.':'Сохранённых сетей пока нет.',
      'New server':'Новый сервер','Name':'Название','Catalog URL':'Адрес каталога','Username':'Имя пользователя','+ Add a server':'+ Добавить сервер',
      'The reader keeps at most':'Максимальное число серверов:','No servers yet.':'Серверы ещё не добавлены.','Server saved.':'Сервер сохранён.',
      'Server removed.':'Сервер удалён.','Reading Stats':'Статистика чтения','System':'Система','Display':'Экран','Reader':'Чтение',
      'Controls':'Управление','Clock':'Часы','Weather':'Погода','KOReader Sync':'Синхронизация KOReader','Customise Status Bar':'Настройка строки состояния',
      'Sleep Screen':'Экран сна','User interface':'Интерфейс','Home screen':'Главный экран','Screen refresh':'Обновление экрана','Reading light':'Подсветка',
      'Left':'Слева','Right':'Справа','Off':'Выкл.','Never':'Никогда','Always':'Всегда','On':'Вкл.','Yes':'Да','No':'Нет',
      'Title':'Название','New':'Новая','Options':'Параметры','Footnotes':'Сноски','Dark':'Тёмная','Light':'Светлая',
      'Reader Font':'Шрифт читалки','TXT/MD Font':'Шрифт TXT/MD','Images':'Изображения','Button Actions':'Действия кнопок',
      'Touch Navigation':'Управление касанием','Automatic Sync':'Автоматическая синхронизация','Downloads':'Загрузки',
      'How the reader last slept and started, and a report to attach to a bug.':'Сведения о последнем переходе в сон и запуске устройства, а также отчёт для сообщения об ошибке.',
      'Reporting a problem? Download this report and attach it to the issue. It holds the firmware version, the device status and the sleep/boot history shown below. It leaves out the IP and MAC address and holds no passwords. The same history is on the reader under Settings → System → Boot Diagnostics.':'Сообщаете о проблеме? Скачайте этот отчёт и приложите его к сообщению. В нём указаны версия прошивки, состояние устройства и история сна и запусков. IP- и MAC-адреса и пароли в отчёт не включаются. Эта же история доступна на устройстве: Настройки → Система → Диагностика запуска.',
      'StarDict dictionaries for looking words up while you read.':'Словари StarDict для поиска слов во время чтения.',
      'Choose the one to look words up in on the reader: Settings → Reader → Dictionary.':'Выберите словарь на устройстве: Настройки → Чтение → Словарь.',
      'ZIP, TAR.GZ, TGZ, TAR.BZ2, TAR':'ZIP, TAR.GZ, TGZ, TAR.BZ2, TAR',
      'Plugins add cards to the File Manager or Settings page.':'Плагины добавляют карточки в файловый менеджер или настройки.',
      'Plugins run in your browser, not on the reader. They can add cards to the File Manager or Settings page, and can make requests only to the internet sites listed below. Read the code before installing a plugin you do not trust.':'Плагины работают в браузере, а не на устройстве. Они могут добавлять карточки в файловый менеджер или настройки и обращаться только к указанным ниже сайтам. Перед установкой незнакомого плагина проверьте его код.',
      'The Reaches line says which internet sites it may contact through this web interface.':'В строке «Доступ» указаны сайты, к которым плагин может обращаться через веб-интерфейс.',
      'A .zip holding a plugin folder: plugin.js, usually manifest.json, and any files they use, all side by side.':'ZIP-архив с папкой плагина: файлы plugin.js, обычно manifest.json и необходимые ему файлы должны находиться рядом.',
      'Changes reach the reader when you save them.':'Изменения применятся на устройстве после сохранения.',
      'Minutes without use before the device goes to sleep; 0 means never.':'Через сколько минут бездействия устройство перейдёт в сон; 0 — никогда.',
      'Fonts, layout, spacing, images and reading aids for the books you read.':'Шрифты, разметка, интервалы, изображения и дополнительные средства чтения.',
      'What each button press, touch gesture and tilt does.':'Действия кнопок, касаний, жестов и наклона устройства.',
      'How the Library lists files, beta updates and checking of secure connections.':'Отображение файлов в библиотеке и параметры защищённых соединений.',
      'The device clock: on or off, time format, time zone and time server.':'Часы устройства: включение, формат времени, часовой пояс и сервер времени.',
      'The weather panel on the Home screen.':'Карточка погоды на главном экране.',
      'Keeps your reading position in step with KOReader and other devices through a sync server.':'Синхронизирует позицию чтения с KOReader и другими устройствами через сервер.',
      'What the status bar around the page shows while you read.':'Сведения, отображаемые в строке состояния во время чтения.',
      'A healthy cycle is a sleep that reached deep sleep (or powered off as asked) followed by a boot that woke from it; two boots in a row mean the session in between ended without sleeping.':'Успешный цикл: устройство перешло в глубокий сон (или отключило питание по запросу), а затем пробудилось. Два запуска подряд означают, что между ними устройство не переходило в сон.',
      'Only the first':'Только первые','files from the dropped folder will be uploaded.':'файлов из перетащенной папки будут загружены.',
      'Files - %%CROSSPOINT%%':'Файлы — X4Libris','File Manager - %%CROSSPOINT%%':'Файловый менеджер — X4Libris',
      'Settings - %%CROSSPOINT%%':'Настройки — X4Libris','Font Manager - %%CROSSPOINT%%':'Менеджер шрифтов — X4Libris',
      'Dictionaries - %%CROSSPOINT%%':'Словари — X4Libris','Reading Stats - %%CROSSPOINT%%':'Статистика чтения — X4Libris',
      'Plugins - %%CROSSPOINT%%':'Плагины — X4Libris','System Info - %%CROSSPOINT%%':'Сведения о системе — X4Libris',
      'Diagnostics - %%CROSSPOINT%%':'Диагностика — X4Libris',
      'All uploads complete!':'Загрузка всех файлов завершена!','Creating folders...':'Создание папок…','Please select at least one file!':'Выберите хотя бы один файл.',
      'Please select at least one item to delete.':'Выберите хотя бы один элемент для удаления.','This folder is empty':'Эта папка пуста',
      'An error occurred while loading the files':'Не удалось загрузить список файлов','Folder':'Папка','FOLDER':'ПАПКА',
      'Upload cancelled by User!':'Загрузка отменена пользователем.','Waiting':'Ожидание','Not started':'Не начато','Saving…':'Сохранение…',
      'Stopped':'Остановлено','Failed':'Не удалось','Done':'Готово','Success':'Успешно','Failed to preview images:':'Не удалось показать изображения:',
      'Conversion will proceed normally.':'Преобразование продолжится в обычном режиме.','No dictionary files, ignored:':'Не словари, пропущены:',
      'Not part of any dictionary (no matching .idx):':'Не входят в словарь (нет соответствующего файла .idx):',
      'Nothing to install':'Нечего устанавливать','unpacked from ':'извлечено из ','words':'слов','Folder: ':'Папка: ',
      'Reaches':'Доступ','Settings categories':'Разделы настроек','Full fetch:':'Полная загрузка:','Fast fetch:':'Быстрая загрузка:',
      'Only install plugins you trust: a plugin can read, change and delete anything on the SD card through this web interface. The Reaches line says which internet sites it may contact through the reader.':'Устанавливайте только те плагины, которым доверяете: через этот веб-интерфейс плагин может читать, изменять и удалять данные на карте SD. В строке «Доступ» перечислены сайты, к которым он может обращаться через устройство.',
      'Plugins run in your browser, not on the reader, and can do anything this web interface can do with your SD card.':'Плагины работают в браузере, а не на устройстве, и могут выполнять любые действия с картой SD, доступные через этот веб-интерфейс.',
      'StarDict dictionaries only. Choose the archive you downloaded (.zip, .tar.gz, .tgz, .tar.bz2 or .tar) or the dictionary\'s own files (.ifo, .idx or .idx.gz, .dict or .dict.dz, and an optional .syn). Compressed parts are unpacked here in your browser, so the reader gets files it can use. Use dictionaries in StarDict format from a source you trust.':'Поддерживаются словари StarDict. Выберите скачанный архив (.zip, .tar.gz, .tgz, .tar.bz2 или .tar) либо файлы словаря (.ifo, .idx или .idx.gz, .dict или .dict.dz и необязательный .syn). Архив будет распакован в браузере, чтобы устройство получило готовые файлы. Используйте словари StarDict только из надёжных источников.',
      'The original stays beside it as':'Исходный файл будет сохранён рядом под именем',
      'An older one is kept as':'Предыдущая копия будет сохранена как',
      'Continue only if you understand that replacing an EPUB can change its reading position and bookmarks when long chapters are split.':'Продолжайте, только если понимаете, что замена EPUB может повлиять на позицию чтения и закладки при разделении длинных глав.',
      'the zip is empty':'архив ZIP пуст','plugin files must sit side by side, without subfolders':'файлы плагина должны лежать рядом, без вложенных папок',
      'there is no plugin.js in the zip':'в архиве нет файла plugin.js','manifest.json is not valid JSON':'файл manifest.json содержит некорректный JSON',
      'could not make a folder name from the zip':'не удалось определить имя папки по ZIP-архиву','bad file name in the catalog':'в каталоге указано неверное имя файла',
      'its manifest.json is not valid JSON':'файл manifest.json содержит некорректный JSON',
      'Loading the catalog...':'Загрузка каталога…','No plugins installed. Install one from the catalog below, or from a .zip file.':'Плагины не установлены. Выберите плагин из каталога ниже или установите его из ZIP-файла.',
      'No reading recorded yet. Open a book and read for a while — your stats will appear here.':'Пока нет данных о чтении. Откройте книгу и почитайте — статистика появится здесь.',
      'Time spent reading on this device, in total and per book. Open a book\'s row for its details.':'Общее время чтения на устройстве и по каждой книге. Откройте строку книги, чтобы посмотреть подробности.',
      'Minutes without use before the device goes to sleep; 0 means never.':'Через сколько минут бездействия устройство перейдёт в сон; 0 — никогда.',
      'What the reader reports about itself.':'Сведения, сообщаемые устройством.',
      'Open Diagnostics':'Открыть диагностику','Fast fetch:':'Быстрый запрос:','Full fetch:':'Полный запрос:',
      'Ready':'Готов','Works':'Работает','Not usable':'Не работает','Choose a file':'Выбрать файл','Choose files':'Выбрать файлы',
      'No file chosen':'Файл не выбран','No files chosen':'Файлы не выбраны','Select files':'Выберите файлы','Select a file':'Выберите файл',
      'Drop files here':'Перетащите файлы сюда','No files selected':'Файлы не выбраны','No images found':'Изображения не найдены',
      'The reader only looks inside folders: each dictionary needs a folder of its own. Install it again from this page.':'Устройство ищет словари только внутри папок. Для каждого словаря нужна отдельная папка. Установите его заново с этой страницы.',
      'The archive is damaged or cut off.':'Архив повреждён или загружен не полностью.','Checking...':'Проверка…',
      'Preparing the card...':'Подготовка карты памяти…','Nothing was installed.':'Ничего не установлено.','Choose a dictionary':'Выберите словарь',
      'All files':'Все файлы','Original size':'Исходный размер','Optimized size':'Размер после обработки','Saved':'Сэкономлено',
      'Images found':'Найдено изображений','Images processed':'Обработано изображений','EPUB repairs':'Исправления EPUB',
      'fixes applied':'исправлений внесено','None needed':'Исправления не требуются','Conversion Summary':'Итоги преобразования',
      'Conversion complete!':'Преобразование завершено!','Starting batch conversion':'Начато пакетное преобразование',
      'Quality:':'Качество:','Overlap:':'Перекрытие:','Rotation:':'Поворот:','Grayscale:':'Оттенки серого:',
      'ON':'Вкл.','OFF':'Выкл.','Normal':'Обычный','H-Split':'Разделить по горизонтали','V-Split':'Разделить по вертикали',
      'Cover':'Обложка','Separator':'Разделитель','Network connection restored':'Подключение к сети восстановлено',
      'Network connection lost':'Подключение к сети потеряно',
      'The Details dialog could not be loaded. Reinstall the web interface at /setup.':'Не удалось открыть сведения о книге. Переустановите веб-интерфейс на странице /setup.',
      'JSZip library not available. Conversion will proceed without image picker.':'Библиотека JSZip недоступна. Преобразование продолжится без выбора изображений.',
      'The file already exists':'Файл уже существует','Cancelled by user':'Отменено пользователем','Upload aborted':'Загрузка прервана',
      'Network error':'Ошибка сети','Upload failed':'Не удалось загрузить файл','Upload complete':'Загрузка завершена',
      'Downloading…':'Загрузка…','Converting & uploading':'Преобразование и загрузка','Uploading':'Загрузка',
      'Please enter a folder name!':'Введите имя папки.','Please enter a new name.':'Введите новое имя.','That folder contains no files.':'В этой папке нет файлов.',
      'No plugin settings are available.':'Настройки плагинов недоступны.','The catalog could not be loaded.':'Не удалось загрузить каталог.',
      'Install from file':'Установить из файла','This plugin is already installed.':'Этот плагин уже установлен.',
      'Updates available':'Доступны обновления','No updates available':'Обновлений нет','Open the reader settings to select it.':'Откройте настройки устройства, чтобы выбрать шрифт.',
      'Settings were saved':'Настройки сохранены','Could not reach the reader':'Не удалось связаться с устройством','The reader is not connected':'Устройство не подключено',
      'Status':'Состояние','Summary':'Итоги','Connected':'Подключено','Disconnected':'Отключено','Unknown':'Неизвестно','N/A':'Нет данных',
      'Yesterday':'Вчера','This month':'В этом месяце','This week':'На этой неделе','Average':'Среднее','Total':'Всего','Current':'Текущая','Last':'Последняя',
      'Back':'Назад','Close':'Закрыть','OK':'ОК','Try again':'Повторить','Refresh':'Обновить','Clear':'Очистить','Apply':'Применить','Select':'Выбрать',
      'Install the web interface':'Установить веб-интерфейс','Installing...':'Установка…','Downloading...':'Загрузка…','Please wait...':'Подождите…'
    };
    window.x4librisWebRuText = text;

    const patterns = [
      [/^The settings could not be loaded: the reader answered (\d+)$/,'Не удалось загрузить настройки: устройство ответило кодом $1.'],
      [/^Could not save: the reader answered (\d+)$/,'Не удалось сохранить: устройство ответило кодом $1.'],
      [/^Could not save the settings: the reader answered (\d+)$/,'Не удалось сохранить настройки: устройство ответило кодом $1.'],
      [/^Could not load the device status: the reader answered (\d+)$/,'Не удалось загрузить состояние устройства: устройство ответило кодом $1.'],
      [/^Error fetching status: the reader answered (\d+)$/,'Ошибка при получении состояния: устройство ответило кодом $1.'],
      [/^The index file must end in lower-case "\.idx"\.$/,'Расширение индексного файла должно быть написано строчными буквами: .idx.'],
      [/^No \.dict or \.dict\.dz file next to (.*)\.$/,'Нет файла .dict или .dict.dz рядом с $1.'],
      [/^No (.*)\.dict or (.*)\.dict\.dz next to the index\.$/,'Рядом с индексом нет файла $1.dict или $2.dict.dz.'],
      [/^Several dictionaries in one folder \((.*)\)\. The reader skips the folder: give each its own folder\.$/,'В одной папке находятся несколько словарей ($1). Устройство пропускает эту папку: поместите каждый словарь в отдельную папку.'],
      [/^The folder name is longer than (\d+) characters\. The reader keeps only that many when you choose it, and then cannot find the folder: rename it\.$/,'Имя папки длиннее $1 символов. Устройство обрезает его при выборе и затем не находит папку. Переименуйте её.'],
      [/^The folder and file names together are too long for the reader \((\d+) characters with the path\): shorten them\.$/,'Общая длина пути и имён файлов превышает допустимые $1 символов. Сократите имена.'],
      [/^The \.idx is (\d+) bytes but the \.ifo says (\d+): the files may not belong together\.$/,'Размер .idx — $1 байт, но в .ifo указано $2. Возможно, файлы относятся к разным словарям.'],
      [/^Not used: (.*) \(using (.*)\)\.$/,'Не используется: $1 (используется $2).'],
      [/^(.*) is plain gzip rather than dictzip\.$/,'$1 сжат обычным gzip, а не dictzip.'],
      [/^The synonyms file is compressed \(\.syn\.gz\) and is ignored\.$/,'Файл синонимов сжат (.syn.gz) и будет пропущен.'],
      [/^It uses 64-bit index offsets \(idxoffsetbits=64\), which the reader does not support\.$/,'Используются 64-разрядные смещения индекса (idxoffsetbits=64), которые устройство не поддерживает.'],
      [/^This kind of archive cannot be read here\. Repack it as \.zip or \.tar\.gz\.$/,'Этот формат архива нельзя прочитать в браузере. Перепакуйте его в .zip или .tar.gz.'],
      [/^No StarDict dictionary found: there is no \.idx or \.idx\.gz file(.*)\.$/,'Словарь StarDict не найден: отсутствует файл .idx или .idx.gz$1.'],
      [/^Reading (.*)$/,'Чтение: $1'],
      [/^unpacking (.*)$/,'распаковка $1'],
      [/^uploading (.*) - (.*) of (.*)(.*)$/,'загрузка $1 — $2 из $3$4'],
      [/^Remove "(.*)"\?\s*This deletes (.*) and everything in it from the card\.$/,'Удалить «$1»? С карты будут удалены «$2» и всё её содержимое.'],
      [/^From: (.*)$/,'Источник: $1'],
      [/^from (.*)$/,'из $1'],
      [/^No dictionaries installed yet\.$/,'Словари ещё не установлены.'],
      [/^No \.ifo file: the dictionary works, but has no title or word count\.$/,'Нет файла .ifo: словарь работает, но у него нет названия и числа слов.'],
      [/^No \.idx index file\.$/,'Нет индексного файла .idx.'],
      [/^The reader skips folders whose name starts with a dot\.$/,'Устройство пропускает папки, название которых начинается с точки.'],
      [/^Could not read the dropped folder: (.*)$/,'Не удалось прочитать перетащенную папку: $1'],
      [/^Could not load stats: (.*)$/,'Не удалось загрузить статистику: $1'],
      [/^Failed to load stats: (.*)$/,'Не удалось загрузить статистику: $1'],
      [/^Could not fetch (.*)$/,'Не удалось получить $1'],
      [/^HTTP (\d+)$/,'HTTP $1'],
      [/^(\d+) words$/,'$1 слов'],
      [/^(\d+) dictionar(?:y|ies), (.*) to upload$/,'Словарей: $1, размер загрузки: $2'],
      [/^(\d+) file(?:s)? selected$/,'Выбрано файлов: $1'],
      [/^(\d+) image(?:s)?$/,'Изображений: $1'],
      [/^(\d+) file(?:s)?$/,'Файлов: $1'],
      [/^No (.*) installed yet\.$/,'Пока не установлено: $1.'],
      [/^No fonts installed$/,'Шрифты не установлены'],
      [/^No remote fonts found$/,'В каталоге нет шрифтов'],
      [/^Installed, update available$/,'Установлен, доступно обновление'],
      [/^Installed, up to date$/,'Установлен, обновлений нет'],
      [/^Not installed$/,'Не установлен'],
      [/^No reading$/,'Нет чтения'],
      [/^no reading$/,'Нет чтения'],
      [/^just now$/,'только что'],
      [/^(\d+)m ago$/,'$1 мин назад'],
      [/^(\d+)h ago$/,'$1 ч назад'],
      [/^(\d+)d ago$/,'$1 дн. назад'],
      [/^(\d+) days ago$/,'$1 дней назад'],
      [/^Failed to load stats: (.*)$/,'Не удалось загрузить статистику: $1'],
      [/^Could not remove the book: (.*)$/,'Не удалось удалить книгу: $1'],
      [/^Could not save: (.*)$/,'Не удалось сохранить: $1'],
      [/^Could not remove: (.*)$/,'Не удалось удалить: $1'],
      [/^The settings could not be loaded: (.*)$/,'Не удалось загрузить настройки: $1'],
      [/^Failed to load stats: (.*)$/,'Не удалось загрузить статистику: $1'],
      [/^Failed to fetch (.*)$/,'Не удалось получить данные: $1'],
      [/^Error loading$/,'Ошибка загрузки'],
      [/^Error fetching status: (.*)$/,'Ошибка при получении состояния: $1'],
      [/^Could not read the dictionaries: (.*)$/,'Не удалось прочитать словари: $1'],
      [/^Could not load the device status\.$/,'Не удалось загрузить состояние устройства.'],
      [/^Some information could not be loaded\.$/,'Не удалось загрузить часть сведений.'],
      [/^No dictionaries installed yet\.$/,'Словари ещё не установлены.'],
      [/^Nothing was installed\.$/,'Ничего не установлено.'],
      [/^Install failed: (.*)$/,'Ошибка установки: $1'],
      [/^Could not install (.*)$/,'Не удалось установить $1'],
      [/^Could not change (.*)$/,'Не удалось изменить $1'],
      [/^Could not remove (.*)$/,'Не удалось удалить $1'],
      [/^Could not delete (.*)$/,'Не удалось удалить $1'],
      [/^Could not save (.*)$/,'Не удалось сохранить $1'],
      [/^Downloading "(.*)"\.\.\.$/,'Загрузка «$1»…'],
      [/^Installed, update available$/,'Установлен, доступно обновление'],
      [/^Installed, up to date$/,'Установлен, обновлений нет'],
      [/^Not installed$/,'Не установлен'],
      [/^(\d+) image(?:s)? \(all selectable\)$/,'Изображений: $1 (все доступны для выбора)'],
      [/^(\d+) images? \((.*) selectable, (.*)\)$/,'Изображений: $1 (доступно для выбора: $2; $3)'],
      [/^Failed to load catalog: (.*)$/,'Не удалось загрузить каталог: $1'],
      [/^Could not load the plugin list\.$/,'Не удалось загрузить список плагинов.'],
      [/^Failed to fetch fast status: (.*)$/,'Не удалось получить текущее состояние: $1'],
      [/^Failed to fetch SD status: (.*)$/,'Не удалось получить сведения о карте SD: $1'],
      [/^Failed to preview images: (.*)$/,'Не удалось показать изображения: $1'],
      [/^Upload complete: (.*)$/,'Загрузка завершена: $1'],
      [/^Converting (.*)$/,'Преобразование: $1'],
      [/^Saving (.*)$/,'Сохранение: $1'],
      [/^Conversion failed, uploading original (.*)$/,'Не удалось преобразовать, загружается исходный файл: $1'],
      [/^Skipped (.*)$/,'Пропущено: $1'],
      [/^Retry$/,'Повторить'],
      [/^There are (\d+) dictionaries?$/,'Словарей: $1'],
      [/^(Files|File Manager|Settings|Font Manager|Dictionaries|Reading Stats|Plugins|System Info|Diagnostics) - (.*)$/,'$1 — $2'],
      [/^Remove "(.*)"\?\s*This deletes (.*) and everything in it from the card\.$/,'Удалить «$1»? С карты будут удалены «$2» и всё её содержимое.'],
      [/^Remove "(.*)" from the SD card\?$/,'Удалить «$1» с карты памяти SD?'],
      [/^Could not remove "(.*)": (.*)$/,'Не удалось удалить «$1»: $2'],
      [/^Removed "(.*)"\.$/,'Удалено: «$1».'],
      [/^Could not delete "(.*)"\.$/,'Не удалось удалить «$1».'],
      [/^Could not change (.*): (.*)$/,'Не удалось изменить $1: $2'],
      [/^(.*) is switched on\.$/,'Плагин «$1» включён.'],
      [/^(.*) is switched off\.$/,'Плагин «$1» выключен.'],
      [/^(.*) is removed\.$/,'Плагин «$1» удалён.'],
      [/^(.*) is installed\.$/,'Плагин «$1» установлен.'],
      [/^(.*) is installed\. Open the (.*) page to use it\.$/,'Плагин «$1» установлен. Откройте раздел «$2», чтобы начать работу.'],
      [/^Could not install (.*): (.*)$/,'Не удалось установить $1: $2'],
      [/^Could not install (.*)\.$/,'Не удалось установить $1.'],
      [/^Installing (.*): (.*) \((\d+)\/(\d+)\)\.\.\.$/,'Установка $1: $2 ($3/$4)…'],
      [/^Downloading "(.*)"\.\.\.$/,'Загрузка «$1»…'],
      [/^Installed "(.*)"\.$/,'Установлено: «$1».'],
      [/^Install failed for "(.*)": (.*)$/,'Не удалось установить «$1»: $2'],
      [/^Deleting (.*)\.\.\.$/,'Удаление $1…'],
      [/^Failed to delete "(.*)"\.$/,'Не удалось удалить «$1».'],
      [/^Delete error: (.*)$/,'Ошибка удаления: $1'],
      [/^Downloading all available updates\.\.\.$/,'Загрузка всех доступных обновлений…'],
      [/^Installed\/updated (\d+) famil(?:y|ies)\.$/,'Установлено или обновлено семейств шрифтов: $1.'],
      [/^Download-all failed: (.*)$/,'Не удалось загрузить обновления: $1'],
      [/^Uploaded (\d+) files?\.?(?: (.*))?$/,'Загружено файлов: $1. $2'],
      [/^Uploading (\d+)\/(\d+): (.*)$/,'Загрузка $1/$2: $3'],
      [/^Preparing upload\.\.\.$/,'Подготовка к загрузке…'],
      [/^Failed on (.*): (.*)$/,'Ошибка для файла $1: $2'],
      [/^Upload error on (.*): (.*)$/,'Ошибка загрузки файла $1: $2'],
      [/^No \.cpfont files selected\.$/,'Файлы .cpfont не выбраны.'],
      [/^Selected files belong to multiple families\.$/,'Выбранные файлы относятся к разным семействам шрифтов.'],
      [/^Pick one or more \.cpfont files\.$/,'Выберите один или несколько файлов .cpfont.'],
      [/^Picked files contain multiple families — please select files from a single family\.$/,'Выбраны файлы нескольких семейств. Выберите файлы только одного семейства.'],
      [/^\d+ files?,?\s*$/,'$&'],
      [/^No fonts installed$/,'Шрифты не установлены'],
      [/^Catalog unavailable$/,'Каталог недоступен'],
      [/^Installed, update available - (.*)$/,'Установлен, доступно обновление — $1'],
      [/^Installed, up to date - (.*)$/,'Установлен, обновлений нет — $1'],
      [/^Not installed - (.*)$/,'Не установлен — $1'],
      [/^By (.*)$/,'Автор: $1'],
      [/^Adds itself to: (.*)$/,'Добавляет раздел: $1'],
      [/^Failed to load stats: (.*)$/,'Не удалось загрузить статистику: $1'],
      [/^Could not remove the book: (.*)$/,'Не удалось удалить книгу: $1'],
      [/^Remove "(.*)" from reading stats\?\s*This only removes its statistics from this device\.$/,'Удалить «$1» из статистики чтения? Данные статистики этой книги будут удалены только с этого устройства.'],
      [/^(\d+) days ago$/,'$1 дн. назад'],
      [/^(\d+) days? ago$/,'$1 дн. назад'],
      [/^No setting matches "(.*)"\.$/,'Нет настроек по запросу «$1».'],
      [/^Could not save: (.*)$/,'Не удалось сохранить: $1'],
      [/^Settings saved\.$/,'Настройки сохранены.'],
      [/^Could not save the settings: (.*)$/,'Не удалось сохранить настройки: $1'],
      [/^Could not load settings: the reader answered (\d+)$/,'Не удалось загрузить настройки: устройство ответило кодом $1.'],
      [/^Could not load the boot history: (.*) answered (\d+)$/,'Не удалось загрузить историю запусков: сервер ответил кодом $2.'],
      [/^Не удалось прочитать словари: Could not list (.*) \((\d+)\)$/,'Не удалось прочитать словари: запрос завершился с кодом $2.'],
      [/^Failed to fetch fast status: (\d+) (.*)$/,'Не удалось получить состояние устройства: код HTTP $1.'],
      [/^Failed to fetch SD status: (\d+) (.*)$/,'Не удалось получить сведения с карты SD: код HTTP $1.'],
      [/^Could not load the device status: the reader answered (\d+)$/,'Не удалось загрузить состояние устройства: устройство ответило кодом $1.'],
      [/^Could not load the device status: (.*)$/,'Не удалось загрузить состояние устройства: $1'],
      [/^Some information could not be loaded\.$/,'Не удалось загрузить часть сведений.'],
      [/^Could not load the plugin list\.$/,'Не удалось загрузить список плагинов.'],
      [/^The catalog could not be loaded\.$/,'Не удалось загрузить каталог.'],
      [/^The catalog could not be loaded\. It comes from GitHub, so this browser needs an internet connection\.$/,'Не удалось загрузить каталог. Он размещён на GitHub, поэтому браузеру требуется подключение к интернету.'],
      [/^The catalog could not be loaded\. It comes from GitHub, so this browser needs an internet connection to reach it\.$/,'Не удалось загрузить каталог. Он размещён на GitHub, поэтому браузеру требуется подключение к интернету.'],
      [/^No dictionaries installed yet\.$/,'Словари ещё не установлены.'],
      [/^Could not read the dictionaries: (.*)$/,'Не удалось прочитать словари: $1'],
      [/^Two dictionaries would go into the same folder "(.*)"\. Give each its own name\.$/,'Два словаря попадут в одну папку «$1». Укажите для каждого своё имя.'],
      [/^Install failed: (.*)$/,'Ошибка установки: $1'],
      [/^Installed (.*)\. Choose (.*) on the reader under Settings → Reader → Dictionary; the first lookup takes a few seconds while it indexes the dictionary\.$/,'Установлено: $1. Выберите словарь на устройстве в разделе Настройки → Чтение → Словарь. При первом поиске потребуется несколько секунд на индексацию.'],
      [/^Nothing was installed\.$/,'Ничего не установлено.'],
      [/^Reading (.*)$/,'Чтение: $1'],
      [/^Checking\.\.\.$/,'Проверка…'],
      [/^Preparing the card\.\.\.$/,'Подготовка карты памяти…'],
      [/^Removing the old (.*)\.\.\.$/,'Удаление старого словаря $1…'],
      [/^Could not create (.*)$/,'Не удалось создать $1'],
      [/^Could not list (.*)$/,'Не удалось получить список: $1'],
      [/^Could not load the device status\.$/,'Не удалось загрузить состояние устройства.'],
      [/^Failed to load stats: (.*)$/,'Не удалось загрузить статистику: $1'],
      [/^Error fetching status: (.*)$/,'Ошибка при получении состояния: $1'],
      [/^Could not read the dropped folder: (.*)$/,'Не удалось прочитать перетащенную папку: $1'],
      [/^Only the first (\d+) files from the dropped folder will be uploaded\.$/,'Будут загружены только первые $1 файлов из перетащенной папки.'],
      [/^That folder contains no files\.$/,'В этой папке нет файлов.'],
      [/^Please enter a folder name!$/,'Введите имя папки.'],
      [/^Please enter a new name\.$/,'Введите новое имя.'],
      [/^File name cannot include slashes\.$/,'В имени файла нельзя использовать косую черту.'],
      [/^Folder name cannot contain (.*)$/,'Имя папки не должно содержать символы $1'],
      [/^Failed to create folder - network error$/,'Не удалось создать папку: ошибка сети.'],
      [/^Failed to rename - network error$/,'Не удалось переименовать: ошибка сети.'],
      [/^Failed to delete - network error$/,'Не удалось удалить: ошибка сети.'],
      [/^Please select at least one file!$/,'Выберите хотя бы один файл.'],
      [/^Please select at least one item to delete\.$/,'Выберите хотя бы один элемент для удаления.'],
      [/^No files selected\.$/,'Файлы не выбраны.'],
      [/^All uploads complete!$/,'Загрузка всех файлов завершена!'],
      [/^Upload cancelled by User!$/,'Загрузка отменена пользователем.'],
      [/^Failed to load font list$/,'Не удалось загрузить список шрифтов'],
      [/^Failed to load catalog: (.*)$/,'Не удалось загрузить каталог: $1'],
      [/^Failed to preview images: (.*)$/,'Не удалось показать изображения: $1'],
      [/^An error occurred while loading the files$/,'Не удалось загрузить список файлов'],
      [/^This folder is empty$/,'Эта папка пуста'],
      [/^Created folder successfully$/,'Папка создана.'],
      [/^Optimizing (.*)$/,'Оптимизация: $1'],
      [/^Optimize (\d+) books$/,'Оптимизировать книги: $1'],
      [/^Optimize the selected EPUBs for the reader, in place$/,'Оптимизировать выбранные EPUB-файлы прямо на карте памяти'],
      [/^Please back up or disable sync before proceeding\.$/,'Перед продолжением создайте резервную копию или отключите синхронизацию.'],
      [/^Could not load the plugin list\.$/,'Не удалось загрузить список плагинов.'],
      [/^Failed to load font list$/,'Не удалось загрузить список шрифтов'],
      [/^Failed to load catalog: (.*)$/,'Не удалось загрузить каталог: $1'],
      [/^Failed to delete: (.*)$/,'Не удалось удалить: $1'],
      [/^Failed to rename: (.*)$/,'Не удалось переименовать: $1'],
      [/^Failed to create folder: (.*)$/,'Не удалось создать папку: $1'],
      [/^Error: (.*)$/,'Ошибка: $1'],
      [/^Loading (.*)$/,'Загрузка: $1'],
      [/^Installing (.*)$/,'Установка: $1'],
      [/^Downloading (.*)$/,'Загрузка: $1'],
      [/^Installed "(.*)"\.$/,'Установлено: «$1».'],
      [/^Deleted "(.*)"\.$/,'Удалено: «$1».'],
      [/^Delete font family "(.*)"\?$/,'Удалить семейство шрифтов «$1»?'],
      [/^No setting matches "(.*)"\.$/,'Нет настроек по запросу «$1».'],
      [/^(\d+) days ago$/,'$1 дн. назад'],
      [/^Finished(.*)$/,'Завершена$1'],
      [/^The file already exists$/,'Файл уже существует'],
      [/^Failed to load files: (.*)$/,'Не удалось загрузить список файлов: $1'],
      [/^Failed to fetch files: (.*)$/,'Не удалось получить список файлов: $1'],
      [/^An error occurred while loading the files:? ?(.*)$/,'Не удалось загрузить список файлов. $1'],
      [/^Could not read the dropped folder: (.*)$/,'Не удалось прочитать перетащенную папку: $1'],
      [/^Only the first (\d+) files from the dropped folder will be uploaded\.$/,'Будут загружены только первые $1 файлов из перетащенной папки.'],
      [/^Starting batch conversion: (\d+) file\(s\)$/,'Начато пакетное преобразование. Файлов: $1.'],
      [/^Starting batch conversion: (.*)$/,'Начато пакетное преобразование: $1'],
      [/^Converting & uploading$/,'Преобразование и загрузка'],
      [/^Uploading original file instead\.\.\.$/,'Загружается исходный файл…'],
      [/^Warning: Failed to process (.*), using original$/,'Предупреждение: не удалось обработать $1, используется исходный файл'],
      [/^Failed to process (.*), using original$/,'Не удалось обработать $1, используется исходный файл'],
      [/^Failed to extract images: (.*)$/,'Не удалось извлечь изображения: $1'],
      [/^Quality: (\d+)% \| Overlap: (\d+)% \| Rotation: (.*) \| Grayscale: (.*)$/,'Качество: $1% | Перекрытие: $2% | Поворот: $3 | Оттенки серого: $4'],
      [/^Conversion complete!$/,'Преобразование завершено!'],
      [/^Upload cancelled by User!$/,'Загрузка отменена пользователем.'],
      [/^Upload cancelled by user!?$/i,'Загрузка отменена пользователем.'],
      [/^Failed to load the device status: (.*)$/,'Не удалось загрузить состояние устройства: $1'],
      [/^Failed to load (.*): (.*)$/,'Не удалось загрузить $1: $2'],
      [/^Failed to fetch (.*): (.*)$/,'Не удалось получить $1: $2'],
      [/^Error loading (.*): (.*)$/,'Ошибка загрузки: $1: $2'],
      [/^Error fetching (.*): (.*)$/,'Ошибка получения данных: $1: $2'],
      [/^Could not (list|read|load|save|delete|remove|rename|move|create|install|upload|download) (.*?)(?:\:| -) (.*)$/i,(_, action, item, reason) => ({list:'Не удалось получить список',read:'Не удалось прочитать',load:'Не удалось загрузить',save:'Не удалось сохранить',delete:'Не удалось удалить',remove:'Не удалось удалить',rename:'Не удалось переименовать',move:'Не удалось переместить',create:'Не удалось создать',install:'Не удалось установить',upload:'Не удалось загрузить',download:'Не удалось скачать'}[action.toLowerCase()] + ' ' + item + ': ' + reason)],
      [/^Please select at least one (file|item|image)(?: to (upload|delete))?[.!]?$/i,(_, what, action) => 'Выберите хотя бы ' + (what.toLowerCase() === 'item' ? 'один элемент' : what.toLowerCase() === 'image' ? 'одно изображение' : 'один файл') + (action === 'upload' ? ' для загрузки.' : action === 'delete' ? ' для удаления.' : '.')],
      [/^Please enter (a folder name|a new name)!?\.?$/i,(_, what) => what.toLowerCase() === 'a folder name' ? 'Введите имя папки.' : 'Введите новое имя.'],
      [/^Could not create (.*) - network error$/,'Не удалось создать $1: ошибка сети.'],
      [/^Could not rename (.*) - network error$/,'Не удалось переименовать $1: ошибка сети.'],
      [/^Could not delete (.*) - network error$/,'Не удалось удалить $1: ошибка сети.'],
      [/^Failed to delete - network error$/,'Не удалось удалить: ошибка сети.'],
      [/^Failed to rename - network error$/,'Не удалось переименовать: ошибка сети.'],
      [/^The folder is empty$/,'Папка пуста'],
      [/^This folder is empty$/,'Эта папка пуста'],
      [/^The selected (\d+) items? (?:was|were) deleted\.$/,'Удалено элементов: $1.'],
      [/^Delete (\d+) items?\?$/,'Удалить элементов: $1?'],
      [/^Uploading (\d+)\/(\d+): (.*)$/,'Загрузка $1/$2: $3'],
      [/^Installing (.*): (.*) \((\d+)\/(\d+)\)\.\.\.$/,'Установка $1: $2 ($3/$4)…'],
      [/^The catalog could not be loaded\. It comes from GitHub, so this browser needs an internet connection(?: to reach it)?\.$/,'Не удалось загрузить каталог. Для доступа к нему этому браузеру нужно подключение к интернету.'],
      [/^No plugins installed\. Install one from the catalog below, or from a \.zip file\.$/,'Плагины не установлены. Выберите плагин из каталога ниже или установите его из ZIP-файла.'],
      [/^No reading recorded yet\.$/,'Пока нет данных о чтении.'],
      [/^The device is offline$/,'Устройство не в сети'],
      [/^Network connection (restored|lost)$/,(m, state) => state === 'restored' ? 'Подключение к сети восстановлено' : 'Подключение к сети потеряно'],
      [/^No file chosen$/,'Файл не выбран'],
      [/^No files chosen$/,'Файлы не выбраны'],
      [/^No items found$/,'Элементы не найдены'],
      [/^No results found$/,'Ничего не найдено'],
      [/^Nothing found$/,'Ничего не найдено'],
      [/^Image load (failed|timeout)$/,(m, why) => why === 'failed' ? 'Не удалось загрузить изображение' : 'Истекло время ожидания изображения'],
      [/^Failed to load (.*)\.$/,'Не удалось загрузить: $1.'],
      [/^Could not load (.*)\.$/,'Не удалось загрузить: $1.'],
      [/^The request failed \((\d+)\)\.?$/,'Запрос завершился с ошибкой ($1).'],
      [/^HTTP (\d+)$/,'Код HTTP $1'],
      [/^Error$/,'Ошибка'],
      [/^Unknown$/,'Неизвестно'],
      [/^N\/A$/,'Нет данных'],
      [/^Connected$/,'Подключено'],
      [/^Disconnected$/,'Отключено'],
      [/^All files$/,'Все файлы'],
      [/^Select a file to upload to$/,'Выберите файл для загрузки в'],
      [/^Drop files to upload to$/,'Перетащите файлы для загрузки в'],
      [/^This action cannot be undone!?$/,'Это действие нельзя отменить.'],
      [/^Are you sure you want to delete the following item\(s\)\?$/,'Удалить выбранные элементы?'],
      [/^The folder holds hidden files; delete it on the device or a computer\.$/,'В папке есть скрытые файлы. Удалите её на устройстве или компьютере.'],
      [/^Saved in this browser for the next upload$/,'Параметры сохраняются в этом браузере для следующей загрузки'],
      [/^Only resized to fit the screen, not turned to grayscale$/,'Обложка только подгоняется под экран, без преобразования в оттенки серого'],
      [/^Export detailed log with statistics$/,'Сохранять подробный журнал со статистикой'],
      [/^The device will restart in USB drive mode\.$/,'Устройство перезапустится в режиме USB-накопителя.'],
      [/^Do not power off!$/,'Не выключайте питание!'],
      [/^Update firmware\?$/,'Обновить прошивку?'],
      [/^Select firmware file \(\.bin\)$/,'Выберите файл прошивки (.bin)'],
      [/^No \.bin files found$/,'Файлы прошивки .bin не найдены'],
      [/^Validating firmware\.\.\.$/,'Проверка файла прошивки…'],
      [/^Invalid firmware file$/,'Неподходящий файл прошивки'],
      [/^Firmware too large for partition$/,'Прошивка не помещается в раздел'],
      [/^Firmware file is too small$/,'Файл прошивки слишком мал'],
      [/^Firmware is for a different device$/,'Прошивка предназначена для другого устройства'],
      [/^Firmware write failed$/,'Не удалось записать прошивку'],
      [/^Recovery Mode$/,'Режим восстановления'],
      [/^Place firmware\.bin on SD card root and select it$/,'Поместите firmware.bin в корень карты SD и выберите его']
    ];
    const attrs = {
      'Font Manager':'Менеджер шрифтов','Finished':'Завершена',
      'Convert from':'Источник шрифта','An EPUB with embedded fonts':'EPUB со встроенными шрифтами',
      'Letters, digits, - and _':'Буквы, цифры, дефис и подчёркивание',
      'Optimize the selected EPUBs for the reader, in place':'Оптимизировать выбранные EPUB-файлы прямо на карте памяти',
      'Minimum quality':'Минимальное качество','Low quality':'Низкое качество','Medium-low quality':'Ниже среднего',
      'Medium quality':'Среднее качество','High quality':'Высокое качество','Maximum quality':'Максимальное качество',
      'Move folder':'Переместить папку','Rename folder':'Переименовать папку','Delete folder':'Удалить папку',
      'Move file':'Переместить файл','Rename file':'Переименовать файл','Delete file':'Удалить файл',
      'Title, author, series and cover':'Название, автор, серия и обложка','Convert from':'Источник шрифта','Font files':'Файлы шрифтов',
      'An EPUB with embedded fonts':'EPUB со встроенными шрифтами','Search settings':'Поиск по настройкам','Settings categories':'Разделы настроек',
      'Unsaved changes':'Несохранённые изменения','Loading':'Загрузка'
    };

    function translated(value) {
      const trimmed = value.trim();
      const normalized = trimmed.replace(/\s+/g, ' ');
      const firmwareTranslation = firmwareRuText[trimmed] || firmwareRuText[normalized];
      if (text[trimmed] || text[normalized] || firmwareTranslation) {
        return value.replace(trimmed, text[trimmed] || text[normalized] || firmwareTranslation);
      }
      const titleMatch = normalized.match(/^(Files|File Manager|Settings|Font Manager|Dictionaries|Reading Stats|Plugins|System Info|Diagnostics) - (.*)$/);
      if (titleMatch) {
        const names = { Files: 'Файлы', 'File Manager': 'Файловый менеджер', Settings: 'Настройки',
          'Font Manager': 'Менеджер шрифтов', Dictionaries: 'Словари', 'Reading Stats': 'Статистика чтения',
          Plugins: 'Плагины', 'System Info': 'Сведения о системе', Diagnostics: 'Диагностика' };
        return value.replace(trimmed, names[titleMatch[1]] + ' — ' + titleMatch[2]);
      }
      for (const [pattern, replacement] of patterns) {
        if (pattern.test(normalized)) return value.replace(trimmed, normalized.replace(pattern, replacement));
      }
      return value;
    }
    function localize(root) {
      if (root.nodeType === Node.TEXT_NODE) {
        if (root.parentElement && root.parentElement.closest('code,pre,.file-link,.folder-link,.file-name,.image-name,.book-title,.book-author,.author-name,.family-name,.dict h3,[data-user-content]')) return;
        const next = translated(root.nodeValue);
        if (next !== root.nodeValue) root.nodeValue = next;
        return;
      }
      if (root.nodeType !== Node.ELEMENT_NODE && root !== document) return;
      if (root.nodeType === Node.ELEMENT_NODE) {
        for (const attr of ['title','placeholder','aria-label','data-title']) {
          if (root.hasAttribute(attr) && attrs[root.getAttribute(attr)]) root.setAttribute(attr, attrs[root.getAttribute(attr)]);
        }
        if (root.tagName === 'OPTION') root.textContent = translated(root.textContent);
      }
      if (root.nodeType === Node.ELEMENT_NODE) {
        for (const element of root.querySelectorAll('[title],[placeholder],[aria-label],[data-title],option')) {
          for (const attr of ['title','placeholder','aria-label','data-title']) {
            if (element.hasAttribute(attr) && attrs[element.getAttribute(attr)]) element.setAttribute(attr, attrs[element.getAttribute(attr)]);
          }
          if (element.tagName === 'OPTION') element.textContent = translated(element.textContent);
        }
      }
      const walker = document.createTreeWalker(root, NodeFilter.SHOW_TEXT);
      const nodes = [];
      while (walker.nextNode()) nodes.push(walker.currentNode);
      nodes.forEach((node) => localize(node));
    }
    document.documentElement.lang = 'ru';
    const titleObserver = new MutationObserver(() => {
      if (document.title) {
        const next = translated(document.title);
        if (next !== document.title) document.title = next;
      }
    });
    titleObserver.observe(document.head, { childList: true, subtree: true, characterData: true });
    new MutationObserver((records) => records.forEach((record) => {
      if (record.type === 'characterData') localize(record.target);
      for (const node of record.addedNodes || []) localize(node);
    })).observe(document.body, { childList: true, subtree: true, characterData: true });
    localize(document.body);
    if (document.title) document.title = translated(document.title);
  })();
</script>
